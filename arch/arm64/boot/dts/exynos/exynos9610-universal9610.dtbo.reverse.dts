/dts-v1/;

/ {
	compatible = "samsung,exynos9610", "samsung,UNIVERSAL9610 A50 Rev 0.1";
	board_id = <0x0>;
	board_rev = <0x0>;

	fragment@battery {
		target-path = [2f 00];

		__overlay__ {

			sm5713-fuelgauge {
				status = "okay";
				fuelgauge,fuel_alert_soc = <0x1>;
				fuelgauge,capacity_max = <0x3e8>;
				fuelgauge,capacity_max_margin = <0x46>;
				fuelgauge,capacity_min = <0x0>;
				fuelgauge,capacity_calculation_type = <0x1f>;

				battery_params {
					battery,id = <0x0>;
					battery0,battery_type = <0x1130 0x0 0x168e>;
					battery0,battery_table0 = <0x1400 0x1b9e 0x1c4e 0x1ccb 0x1d26 0x1d6f 0x1d86 0x1da0 0x1ddf 0x1e04 0x1e2d 0x1e4c 0x1e68 0x1e8a 0x1eb5 0x1eec 0x1f14 0x1f56 0x1fb0 0x1fff 0x2091 0x2146 0x2236 0x2400>;
					battery0,battery_table1 = <0x0 0xda 0x1eb 0x2fc 0x40d 0x5a6 0xafb 0xda5 0x12fa 0x184e 0x1da3 0x22f7 0x284c 0x2da1 0x32f5 0x384a 0x3af4 0x3d9e 0x42f3 0x4848 0x5046 0x5956 0x6400 0x644c>;
					battery0,battery_table2 = <0x1ae 0x1ae 0x1ae 0x1ae 0x1ae 0x1ae 0x1ae 0x1ae 0x1ae 0x1ae 0x1ae 0x1ae 0x1ae 0x1ae 0x1ae 0x1ae>;
					battery0,rce_value = <0x4e1 0x3e6 0x1d7>;
					battery0,rs_value = <0xa4 0x147 0x146 0x3800 0x7a>;
					battery0,misc = <0x0>;
					battery0,topoff_soc = <0x0 0x3 0x0>;
					battery0,vit_period = <0xa0a>;
					battery0,dtcd_value = <0x1>;
					battery0,volt_cal = <0x8000>;
					battery0,curr_offset = <0x1 0x0 0x0 0x0 0x0 0x0 0x0>;
					battery0,mix_value = <0x103 0x4>;
					battery0,temp_std = <0x19>;
					battery0,temp_cal = <0x0 0x6 0x1 0xb 0xffffffff 0x1 0x6 0x1 0x9 0x1>;
					battery0,ext_temp_cal = <0x0 0x2 0x1 0x2 0x1 0x1 0x2 0x3 0x2 0x3>;
					battery0,temp_volcal = <0x1 0xf 0x1>;
					battery0,temp_offset = <0x1 0xb 0x1 0x1 0x8 0xffffffff>;
					battery0,curr_cal = <0x8080 0x8080 0x8080 0x8080 0x8080 0x8080>;
					battery0,tem_poff = <0xd48 0x32 0xcb2 0x32>;
					battery0,arsm = <0x1 0x3 0x1 0x6>;
					battery0,cycle_cfg = <0x0 0x0 0x0>;
					battery0,full_offset = <0x0 0x0>;
					battery0,v_offset_cancel = <0x0 0x0 0x64 0xa>;
					battery0,v_alarm = <0xc1c 0x0>;
					battery0,data_ver = <0x1>;
				};
			};

			pdic-manager {
				pdic,max_power = <0x1388>;
				pdic,op_power = <0x9c4>;
				pdic,max_voltage = <0x1770>;
				pdic,max_current = <0x7d0>;
				pdic,min_current = <0x1f4>;
				pdic,giveback = <0x0>;
				pdic,usb_com_capable = <0x1>;
				pdic,no_usb_suspend = <0x1>;
				source,max_voltage = <0x1388>;
				source,min_voltage = <0xfa0>;
				source,max_power = <0x9c4>;
			};

			battery {
				status = "okay";
				compatible = "samsung,sec-battery";
				pinctrl-names = "default";
				battery,vendor = "SDI SDI";
				battery,charger_name = "sm5713-charger";
				battery,fuelgauge_name = "sm5713-fuelgauge";
				battery,technology = <0x2>;
				battery,chip_vendor = "LSI";
				battery,temp_adc_type = <0x1>;
				battery,usb_temp_check_type = <0x0>;
				battery,chg_temp_check_type = <0x2>;
				battery,wpc_temp_check_type = <0x0>;
				battery,thermal_source = <0x3>;
				battery,usb_thermal_source = <0x0>;
				battery,chg_thermal_source = <0x3>;
				battery,wpc_thermal_source = <0x0>;
				battery,polling_time = <0xa 0x1e 0x1e 0x1e 0xe10>;
				battery,temp_table_adc = <0xec 0x134 0x185 0x1db 0x21f 0x26e 0x2a2 0x2ff 0x335 0x387 0x419 0x4b8 0x534 0x57d 0x5c9 0x636 0x718 0x7ea 0x8cd 0x9bd 0xa45 0xa9e 0xaf9 0xb7b 0xc2b 0xcea 0xd67 0xdf1 0xe5c>;
				battery,temp_table_data = <0x384 0x352 0x320 0x2ee 0x2bc 0x28a 0x26c 0x258 0x244 0x226 0x1f4 0x1c2 0x1a4 0x190 0x17c 0x15e 0x12c 0xfa 0xc8 0x96 0x78 0x64 0x50 0x32 0x0 0xffffffce 0xffffff9c 0xffffff6a 0xffffff38>;
				battery,chg_temp_table_adc = <0xec 0x134 0x178 0x1c1 0x1fd 0x245 0x251 0x2f8 0x330 0x385 0x416 0x4bb 0x536 0x57d 0x5ca 0x632 0x6fe 0x7d1 0x8a9 0x98d 0xa0a 0xa5f 0xab4 0xb2a 0xbe6 0xc7f 0xd07 0xd7d 0xdd1>;
				battery,chg_temp_table_data = <0x384 0x352 0x320 0x2ee 0x2bc 0x28a 0x26c 0x258 0x244 0x226 0x1f4 0x1c2 0x1a4 0x190 0x17c 0x15e 0x12c 0xfa 0xc8 0x96 0x78 0x64 0x50 0x32 0x0 0xffffffce 0xffffff9c 0xffffff6a 0xffffff38>;
				battery,input_current_limit = <0x708 0x1c2 0x1c2 0x708 0x1f4 0x384 0x5dc 0x1c2 0x3e8 0x1c2 0x384 0x384 0x384 0x76c 0x708 0x1c2 0x1c2 0x190 0x2bc 0x514 0x12c 0x3e8 0x5dc 0x1c2 0x672 0x834 0x1f4 0x672 0x50 0x708 0x672 0x578 0x3e8 0x3e8 0x2bc 0x384 0x384 0x384 0x1f4 0x708 0x672 0xbb8>;
				battery,fast_charging_current = <0x834 0x1c2 0x1c2 0x834 0x320 0x4b0 0x5dc 0x1c2 0x4b0 0x1c2 0x834 0x834 0x834 0x640 0x834 0x1c2 0x1c2 0x190 0x2bc 0x514 0x12c 0x3e8 0x5dc 0x1c2 0x960 0xdac 0x1f4 0x960 0x50 0x708 0x3e8 0x578 0x1c2 0x3e8 0x834 0x834 0x834 0x834 0x1c2 0x834 0x960 0xbb8>;
				battery,full_check_current_1st = <0x12c 0x0 0x0 0x12c 0x12c 0x12c 0x12c 0x12c 0x12c 0x0 0x12c 0x12c 0x12c 0x12c 0x12c 0x0 0x0 0x12c 0x12c 0x12c 0x12c 0x12c 0x12c 0x0 0x12c 0x12c 0x12c 0x12c 0x0 0x12c 0x12c 0x12c 0x0 0x12c 0x12c 0x12c 0x12c 0x12c 0x12c 0x12c 0x12c 0x12c>;
				battery,full_check_current_2nd = <0x64 0x0 0x0 0x64 0x64 0x64 0x64 0x64 0x64 0x0 0x64 0x64 0x64 0x64 0x64 0x0 0x0 0x64 0x64 0x64 0x64 0x64 0x64 0x0 0x64 0x64 0x64 0x64 0x0 0x64 0x64 0x64 0x0 0x64 0x64 0x64 0x64 0x64 0x64 0x64 0x64 0x64>;
				battery,wireless_cc_cv = <0x55>;
				battery,inbat_voltage = <0x1>;
				battery,inbat_voltage_table_adc = <0xb01 0xaf3 0xadf 0xac1 0xaa8 0xa8d 0xa78 0xa5e 0xa44 0xa25 0xa05 0x9e8 0x9cd 0x9ae 0x992 0x97a 0x961 0x944 0x927 0x911 0x8f2>;
				battery,inbat_voltage_table_data = <0x111f 0x1100 0x10d2 0x109d 0x106c 0x1038 0x1005 0xfd5 0xfa2 0xf72 0xf3f 0xf0c 0xed9 0xea6 0xe76 0xe46 0xe11 0xde0 0xdaf 0xd80 0xd4a>;
				battery,adc_check_count = <0x5>;
				battery,cable_check_type = <0x4>;
				battery,cable_source_type = <0x1>;
				battery,polling_type = <0x1>;
				battery,monitor_initial_count = <0x0>;
				battery,pre_afc_input_current = <0x1f4>;
				battery,battery_check_type = <0x0>;
				battery,check_count = <0x0>;
				battery,check_adc_max = <0x5a0>;
				battery,check_adc_min = <0x0>;
				battery,ovp_uvlo_check_type = <0x3>;
				battery,temp_check_type = <0x2>;
				battery,temp_check_count = <0x1>;
				battery,temp_highlimit_threshold_normal = <0x320>;
				battery,temp_highlimit_recovery_normal = <0x2ee>;
				battery,temp_high_threshold_normal = <0x1f4>;
				battery,temp_high_recovery_normal = <0x1c2>;
				battery,temp_low_threshold_normal = <0x0>;
				battery,temp_low_recovery_normal = <0x32>;
				battery,temp_highlimit_threshold_lpm = <0x320>;
				battery,temp_highlimit_recovery_lpm = <0x2ee>;
				battery,temp_high_threshold_lpm = <0x1f4>;
				battery,temp_high_recovery_lpm = <0x1c2>;
				battery,temp_low_threshold_lpm = <0x0>;
				battery,temp_low_recovery_lpm = <0x32>;
				battery,full_check_type = <0x2>;
				battery,full_check_type_2nd = <0x2>;
				battery,full_check_count = <0x1>;
				battery,chg_gpio_full_check = <0x0>;
				battery,chg_polarity_full_check = <0x1>;
				battery,chg_heating_prevention_method = <0x1>;
				battery,chg_12v_high_temp = <0x267>;
				battery,chg_high_temp = <0x1d1>;
				battery,chg_high_temp_recovery = <0x1cc>;
				battery,chg_charging_limit_current = <0x44c>;
				battery,wpc_high_temp = <0x1cc 0x1ef>;
				battery,wpc_high_temp_recovery = <0x1cb 0x190>;
				battery,wpc_charging_limit_current = <0x21c 0x190>;
				battery,wpc_heat_temp_recovery = <0x168>;
				battery,wpc_lcd_on_high_temp = <0x1d6>;
				battery,wpc_lcd_on_high_temp_rec = <0x12c>;
				battery,wpc_hv_lcd_on_input_limit_current = <0x190>;
				battery,sleep_mode_limit_current = <0x1f4>;
				battery,wc_full_input_limit_current = <0x64>;
				battery,wc_heating_input_limit_current = <0x190>;
				battery,wc_heating_time = <0x12c>;
				battery,wc_cv_current = <0x334>;
				battery,wc_cv_pack_current = <0x276>;
				battery,mix_high_temp = <0x1a4>;
				battery,mix_high_chg_temp = <0x1f4>;
				battery,mix_high_temp_recovery = <0x186>;
				battery,full_condition_type = <0xd>;
				battery,full_condition_soc = <0x5d>;
				battery,full_condition_vcell = <0x109a>;
				battery,recharge_check_count = <0x1>;
				battery,recharge_condition_type = <0x4>;
				battery,recharge_condition_soc = <0x62>;
				battery,recharge_condition_vcell = <0x10cc>;
				battery,charging_total_time = <0x5460>;
				battery,recharging_total_time = <0x1518>;
				battery,charging_reset_time = <0x0>;
				battery,chg_float_voltage = <0x10fe>;
				battery,swelling_high_temp_block = <0x19a>;
				battery,swelling_high_temp_recov = <0x168>;
				battery,swelling_low_temp_block = <0x64>;
				battery,swelling_low_temp_recov = <0x96>;
				battery,swelling_low_temp_additional = <0x32>;
				battery,swelling_low_temp_current = <0x546>;
				battery,swelling_low_temp_additional_current = <0x20d>;
				battery,swelling_low_temp_topoff = <0x96>;
				battery,swelling_high_temp_current = <0x546>;
				battery,swelling_high_temp_topoff = <0x96>;
				battery,swelling_drop_float_voltage = <0x1036>;
				battery,swelling_high_rechg_voltage = <0x1004>;
				battery,swelling_low_rechg_voltage = <0xfa0>;
				battery,self_discharging_temp_block = <0x258>;
				battery,self_discharging_volt_block = <0x109a>;
				battery,self_discharging_temp_recov = <0x226>;
				battery,self_discharging_temp_pollingtime = <0x190>;
				battery,siop_event_check_type = <0x1>;
				battery,siop_call_cv_current = <0x14a>;
				battery,siop_call_cc_current = <0x14a>;
				battery,siop_input_limit_current = <0x4b0>;
				battery,siop_charging_limit_current = <0x3e8>;
				battery,siop_hv_input_limit_current = <0x2bc>;
				battery,siop_hv_charging_limit_current = <0x4b0>;
				battery,siop_hv_12v_input_limit_current = <0x217>;
				battery,siop_hv_12v_charging_limit_current = <0x3e8>;
				battery,siop_wireless_input_limit_current = <0x258>;
				battery,siop_wireless_charging_limit_current = <0x3e8>;
				battery,siop_hv_wireless_input_limit_current = <0x258>;
				battery,siop_hv_wireless_charging_limit_current = <0x3e8>;
				battery,ttf_hv_12v_charge_current = <0x92e>;
				battery,ttf_hv_charge_current = <0x898>;
				battery,ttf_hv_wireless_charge_current = <0x5dc>;
				battery,age_data = <0x0 0xaa69 0x10d8 0x10b3 0x5d 0x12c 0xa8f2 0x10b3 0x1072 0x59 0x1f4 0xa77b 0x108d 0x104a 0x55>;
				battery,step_charging_type = <0x5>;
				battery,step_charging_charge_power = <0x4e20>;
				battery,step_charging_condtion = <0x1004 0x1130>;
				battery,step_charging_current = <0x1068 0xbb8>;
				battery,base_charge_power = <0x3a98>;
				battery,max_charging_current = <0x960>;
				battery,max_input_voltage = <0x2328>;
				battery,max_input_current = <0xbb8>;
				battery,prepare_afc_delay = <0x0>;
				io-channels = <0xffffffff 0x1 0xffffffff 0x2 0xffffffff 0x3>;
				io-channel-names = "adc-temp", "adc-in-bat", "adc-chg-temp";
				#io-channel-cells = <0x5>;
				io-channel-ranges;
			};

			cable-info {
				default_input_current = <0x708>;
				default_charging_current = <0x834>;
				full_check_current_1st = <0x12c>;
				full_check_current_2nd = <0x64>;

				current_group_1 {
					cable_number = <0x2 0x13 0x15 0x16 0x17 0x1e>;
					input_current = <0x1f4>;
					charging_current = <0x1f4>;
				};

				current_group_2 {
					cable_number = <0x19 0x1f>;
					input_current = <0x3e8>;
					charging_current = <0x3e8>;
				};

				current_group_3 {
					cable_number = <0x5 0x20>;
					input_current = <0x5dc>;
					charging_current = <0x5dc>;
				};

				current_group_4 {
					cable_number = <0x6 0x7 0x8>;
					input_current = <0x672>;
					charging_current = <0x960>;
				};

				current_group_5 {
					cable_number = <0x9>;
					input_current = <0x672>;
					charging_current = <0x960>;
				};

				current_group_6 {
					cable_number = <0xa 0xc 0xe 0xf 0x1b>;
					input_current = <0x384>;
					charging_current = <0x578>;
				};

				current_group_7 {
					cable_number = <0xd>;
					input_current = <0x2bc>;
					charging_current = <0x578>;
				};

				current_group_8 {
					cable_number = <0x18>;
					input_current = <0x3e8>;
					charging_current = <0x1c2>;
				};

				current_group_9 {
					cable_number = <0xb 0x10 0x1c>;
					input_current = <0x28a>;
					charging_current = <0x578>;
				};

				current_group_10 {
					cable_number = <0x1d>;
					input_current = <0x1f4>;
					charging_current = <0x578>;
				};

				current_group_11 {
					cable_number = <0x1 0x4>;
					input_current = <0x1f4>;
					charging_current = <0x1f4>;
				};
			};
		};
	};

	fragment@0 {
		target = <0xffffffff>;

		__overlay__ {

			usbpd-irq {
				samsung,pins = "gpa2-3";
				samsung,pin-function = <0xf>;
				samsung,pin-pud = <0x0>;
				samsung,pin-drv = <0x0>;
				linux,phandle = <0x1>;
				phandle = <0x1>;
			};
		};
	};

	fragment@1 {
		target = <0xffffffff>;

		__overlay__ {

			chg-en {
				samsung,pins = "gpg2-3";
				samsung,pin-function = <0x1>;
				samsung,pin-pud = <0x1>;
				samsung,pin-drv = <0x0>;
				linux,phandle = <0x15>;
				phandle = <0x15>;
			};
		};
	};

	fragment@2 {
		target = <0xffffffff>;

		__overlay__ {
			i2c-gpio,delay-us = <0x5>;
			status = "okay";
			#address-cells = <0x1>;
			#size-cells = <0x0>;

			usbpd-5713@33 {
				compatible = "sm5713-usbpd,i2c";
				reg = <0x33>;
				pinctrl-names = "default";
				vconn-en;
				pinctrl-0 = <0x1>;
				usbpd,usbpd_int = <0xffffffff 0x3 0x0>;
			};
		};
	};

	fragment@modemif {
		target-path = [2f 00];

		__overlay__ {
			#address-cells = <0x2>;
			#size-cells = <0x1>;

			mif_pdata {
				reg = <0x0 0x10000 0x0>;
				compatible = "sec_modem,modem_pdata";
				status = "okay";
				interrupts = <0x0 0x4b 0x0>;
				mif,name = "s337ap";
				mif,modem_net = <0x0>;
				mif,modem_type = <0xa>;
				mif,use_handover = <0x0>;
				mif,ipc_version = <0x32>;
				mif,link_types = <0x200>;
				mif,link_name = "shmem";
				mif,link_attrs = <0x7c9>;
				mif,num_iodevs = <0x16>;
				mif,use_usb_phy = <0x0>;
				mbx_ap2cp_msg = <0x0>;
				mbx_cp2ap_msg = <0x1>;
				mbx_ap2cp_united_status = <0x2>;
				mbx_cp2ap_united_status = <0x3>;
				mbx_ap2cp_mif_value = <0x4>;
				mbx_ap2cp_kerneltime = <0x9>;
				mbx_cp2ap_pcie_l1ss_disable = <0x11>;
				mif,int_ap2cp_msg = <0x0>;
				mif,int_ap2cp_wakeup = <0x1>;
				mif,int_ap2cp_status = <0x2>;
				mif,int_ap2cp_active = <0x3>;
				mif,irq_cp2ap_msg = <0x0>;
				mif,irq_cp2ap_status = <0x2>;
				mif,irq_cp2ap_active = <0x3>;
				mif,irq_cp2ap_wakelock = <0x8>;
				mif,irq_cp2ap_pcie_l1ss_disable = <0x9>;
				mif,int_ap2cp_uart_noti = <0xf>;
				mbx_cp2ap_dvfsreq = <0x4>;
				mbx_cp2ap_dvfsreq_cpu = <0x5>;
				mbx_cp2ap_dvfsreq_mif = <0x6>;
				mbx_cp2ap_dvfsreq_int = <0x7>;
				mif,irq_cp2ap_perf_req_cpu = <0x5>;
				mif,irq_cp2ap_perf_req_mif = <0x6>;
				mif,irq_cp2ap_perf_req_int = <0x7>;
				sbi_cp_rat_mode_mask = <0x3f>;
				sbi_cp_rat_mode_pos = <0x1a>;
				sbi_cp_evs_mode_mask = <0x1>;
				sbi_cp_evs_mode_pos = <0x7>;
				sbi_cp2ap_wakelock_mask = <0x1>;
				sbi_cp2ap_wakelock_pos = <0x6>;
				sbi_lte_active_mask = <0x1>;
				sbi_lte_active_pos = <0x5>;
				sbi_cp_status_mask = <0xf>;
				sbi_cp_status_pos = <0x1>;
				sbi_pda_active_mask = <0x1>;
				sbi_pda_active_pos = <0x5>;
				sbi_ap_status_mask = <0xf>;
				sbi_ap_status_pos = <0x1>;
				sbi_crash_type_mask = <0xf>;
				sbi_crash_type_pos = <0x19>;
				sbi_device_type_mask = <0x1f>;
				sbi_device_type_pos = <0x14>;
				sbi_ext_backtrace_mask = <0x1>;
				sbi_ext_backtrace_pos = <0x11>;
				sbi_ds_det_mask = <0x3>;
				sbi_ds_det_pos = <0xe>;
				sbi_sys_rev_mask = <0xff>;
				sbi_sys_rev_pos = <0x6>;
				sbi_lockval_cp2ap_dvfsreq_endian_mask = <0x1>;
				sbi_lockval_cp2ap_dvfsreq_endian_pos = <0x1f>;
				sbi_lockval_cp2ap_dvfsreq_index_mask = <0x7fff>;
				sbi_lockval_cp2ap_dvfsreq_index_pos = <0x0>;
				sbi_ap2cp_kerneltime_sec_mask = <0xfff>;
				sbi_ap2cp_kerneltime_sec_pos = <0x14>;
				sbi_ap2cp_kerneltime_usec_mask = <0xfffff>;
				sbi_ap2cp_kerneltime_usec_pos = <0x0>;
				sbi_uart_noti_mask = <0x1>;
				sbi_uart_noti_pos = <0x10>;

				iodevs {

					io_device_0 {
						iod,name = "umts_ipc0";
						iod,id = <0xeb>;
						iod,format = <0x0>;
						iod,io_type = <0x0>;
						iod,links = <0x200>;
						iod,attrs = <0x82>;
						iod,app = "RIL";
						iod,ul_num_buffers = <0x10>;
						iod,ul_buffer_size = <0x1000>;
						iod,dl_num_buffers = <0x20>;
						iod,dl_buffer_size = <0x1000>;
					};

					io_device_1 {
						iod,name = "umts_ipc1";
						iod,id = <0xec>;
						iod,format = <0x0>;
						iod,io_type = <0x0>;
						iod,links = <0x200>;
						iod,attrs = <0x82>;
						iod,app = "RIL";
						iod,ul_num_buffers = <0x10>;
						iod,ul_buffer_size = <0x1000>;
						iod,dl_num_buffers = <0x20>;
						iod,dl_buffer_size = <0x1000>;
					};

					io_device_2 {
						iod,name = "umts_rfs0";
						iod,id = <0xf5>;
						iod,format = <0x2>;
						iod,io_type = <0x0>;
						iod,links = <0x200>;
						iod,attrs = <0x82>;
						iod,app = "RFS";
						iod,ul_num_buffers = <0x10>;
						iod,ul_buffer_size = <0x800>;
						iod,dl_num_buffers = <0x200>;
						iod,dl_buffer_size = <0x800>;
					};

					io_device_3 {
						iod,name = "umts_csd";
						iod,id = <0x1>;
						iod,format = <0x1>;
						iod,io_type = <0x0>;
						iod,links = <0x200>;
						iod,attrs = <0x82>;
						iod,app = "CSVT";
						iod,ul_num_buffers = <0x20>;
						iod,ul_buffer_size = <0x800>;
						iod,dl_num_buffers = <0x40>;
						iod,dl_buffer_size = <0x800>;
					};

					io_device_4 {
						iod,name = "umts_router";
						iod,id = <0x19>;
						iod,format = <0x1>;
						iod,io_type = <0x0>;
						iod,links = <0x200>;
						iod,attrs = <0x82>;
						iod,app = "Data Router";
						iod,max_tx_size = <0x60e>;
						iod,ul_num_buffers = <0x10>;
						iod,ul_buffer_size = <0x800>;
						iod,dl_num_buffers = <0x10>;
						iod,dl_buffer_size = <0x800>;
					};

					io_device_5 {
						iod,name = "umts_dm0";
						iod,id = <0x1c>;
						iod,format = <0x1>;
						iod,io_type = <0x0>;
						iod,links = <0x200>;
						iod,attrs = <0x82>;
						iod,app = "DIAG";
						iod,ul_num_buffers = <0x10>;
						iod,ul_buffer_size = <0x800>;
						iod,dl_num_buffers = <0x80>;
						iod,dl_buffer_size = <0x800>;
					};

					io_device_6 {
						iod,name = "ipc_loopback0";
						iod,id = <0xf4>;
						iod,format = <0x0>;
						iod,io_type = <0x0>;
						iod,links = <0x200>;
						iod,attrs = <0x82>;
						iod,app = "CLD";
						iod,ul_num_buffers = <0x10>;
						iod,ul_buffer_size = <0x800>;
						iod,dl_num_buffers = <0x20>;
						iod,dl_buffer_size = <0x800>;
					};

					io_device_7 {
						iod,name = "rmnet0";
						iod,id = <0xa>;
						iod,format = <0x1>;
						iod,io_type = <0x1>;
						iod,links = <0x200>;
						iod,attrs = <0x180>;
						iod,app = "NET";
						iod,ul_num_buffers = <0x0>;
						iod,ul_buffer_size = <0x800>;
						iod,dl_num_buffers = <0x0>;
						iod,dl_buffer_size = <0x800>;
					};

					io_device_8 {
						iod,name = "rmnet1";
						iod,id = <0xb>;
						iod,format = <0x1>;
						iod,io_type = <0x1>;
						iod,links = <0x200>;
						iod,attrs = <0x180>;
						iod,app = "NET";
						iod,ul_num_buffers = <0x0>;
						iod,ul_buffer_size = <0x800>;
						iod,dl_num_buffers = <0x0>;
						iod,dl_buffer_size = <0x800>;
					};

					io_device_9 {
						iod,name = "rmnet2";
						iod,id = <0xc>;
						iod,format = <0x1>;
						iod,io_type = <0x1>;
						iod,links = <0x200>;
						iod,attrs = <0x180>;
						iod,app = "NET";
						iod,ul_num_buffers = <0x0>;
						iod,ul_buffer_size = <0x800>;
						iod,dl_num_buffers = <0x0>;
						iod,dl_buffer_size = <0x800>;
					};

					io_device_10 {
						iod,name = "rmnet3";
						iod,id = <0xd>;
						iod,format = <0x1>;
						iod,io_type = <0x1>;
						iod,links = <0x200>;
						iod,attrs = <0x180>;
						iod,app = "NET";
						iod,ul_num_buffers = <0x0>;
						iod,ul_buffer_size = <0x800>;
						iod,dl_num_buffers = <0x0>;
						iod,dl_buffer_size = <0x800>;
					};

					io_device_11 {
						iod,name = "rmnet4";
						iod,id = <0xe>;
						iod,format = <0x1>;
						iod,io_type = <0x1>;
						iod,links = <0x200>;
						iod,attrs = <0x180>;
						iod,ul_num_buffers = <0x0>;
						iod,ul_buffer_size = <0x800>;
						iod,dl_num_buffers = <0x0>;
						iod,dl_buffer_size = <0x800>;
					};

					io_device_12 {
						iod,name = "rmnet5";
						iod,id = <0xf>;
						iod,format = <0x1>;
						iod,io_type = <0x1>;
						iod,links = <0x200>;
						iod,attrs = <0x180>;
						iod,ul_num_buffers = <0x0>;
						iod,ul_buffer_size = <0x800>;
						iod,dl_num_buffers = <0x0>;
						iod,dl_buffer_size = <0x800>;
					};

					io_device_13 {
						iod,name = "rmnet6";
						iod,id = <0x10>;
						iod,format = <0x1>;
						iod,io_type = <0x1>;
						iod,links = <0x200>;
						iod,attrs = <0x180>;
						iod,ul_num_buffers = <0x0>;
						iod,ul_buffer_size = <0x800>;
						iod,dl_num_buffers = <0x0>;
						iod,dl_buffer_size = <0x800>;
					};

					io_device_14 {
						iod,name = "rmnet7";
						iod,id = <0x11>;
						iod,format = <0x1>;
						iod,io_type = <0x1>;
						iod,links = <0x200>;
						iod,attrs = <0x180>;
						iod,ul_num_buffers = <0x0>;
						iod,ul_buffer_size = <0x800>;
						iod,dl_num_buffers = <0x0>;
						iod,dl_buffer_size = <0x800>;
					};

					io_device_15 {
						iod,name = "multipdp_hiprio";
						iod,id = <0x0>;
						iod,format = <0x3>;
						iod,io_type = <0x2>;
						iod,links = <0x200>;
						iod,attrs = <0x180>;
						iod,app = "RIL";
						iod,ul_num_buffers = <0x100>;
						iod,ul_buffer_size = <0x800>;
						iod,dl_num_buffers = <0x100>;
						iod,dl_buffer_size = <0x800>;
					};

					io_device_16 {
						iod,name = "multipdp";
						iod,id = <0x0>;
						iod,format = <0x3>;
						iod,io_type = <0x2>;
						iod,links = <0x200>;
						iod,attrs = <0x180>;
						iod,app = "RIL";
						iod,ul_num_buffers = <0x200>;
						iod,ul_buffer_size = <0x800>;
						iod,dl_num_buffers = <0x400>;
						iod,dl_buffer_size = <0x800>;
					};

					io_device_17 {
						iod,name = "umts_boot0";
						iod,id = <0xd7>;
						iod,format = <0x4>;
						iod,io_type = <0x0>;
						iod,links = <0x200>;
						iod,attrs = <0x2>;
						iod,app = "CBD";
					};

					io_device_18 {
						iod,name = "umts_ramdump0";
						iod,id = <0xe1>;
						iod,format = <0x5>;
						iod,io_type = <0x0>;
						iod,links = <0x200>;
						iod,attrs = <0x202>;
						iod,app = "CBD";
					};

					io_device_19 {
						iod,name = "umts_atc0";
						iod,id = <0x20>;
						iod,format = <0x1>;
						iod,io_type = <0x0>;
						iod,links = <0x200>;
						iod,attrs = <0x882>;
						iod,app = "VCD";
						iod,max_tx_size = <0x800>;
						iod,ul_num_buffers = <0x10>;
						iod,ul_buffer_size = <0x800>;
						iod,dl_num_buffers = <0x80>;
						iod,dl_buffer_size = <0x800>;
						iod,option_region = "usa_vzw";
					};

					io_device_20 {
						iod,name = "smd4";
						iod,id = <0x21>;
						iod,format = <0x1>;
						iod,io_type = <0x0>;
						iod,links = <0x200>;
						iod,attrs = <0x882>;
						iod,ul_num_buffers = <0x10>;
						iod,ul_buffer_size = <0x800>;
						iod,dl_num_buffers = <0x80>;
						iod,dl_buffer_size = <0x800>;
						iod,option_region = "kor_single";
					};

					io_device_21 {
						iod,name = "umts_ciq0";
						iod,id = <0x1a>;
						iod,format = <0x1>;
						iod,io_type = <0x0>;
						iod,links = <0x200>;
						iod,attrs = <0x882>;
						iod,ul_num_buffers = <0x10>;
						iod,ul_buffer_size = <0x800>;
						iod,dl_num_buffers = <0x80>;
						iod,dl_buffer_size = <0x800>;
						iod,option_region = "usa_";
					};
				};
			};

			shmem@F0000000 {
				compatible = "samsung,exynos-shm_ipc";
				shmem,cp_size = <0x7900000>;
				shmem,vss_size = <0x700000>;
				shmem,ipc_offset = <0x8000000>;
				shmem,ipc_size = <0x800000>;
				linux,phandle = <0x17>;
				phandle = <0x17>;
			};
		};
	};

	fragment@lcd {
		target-path = [2f 00];

		__overlay__ {

			emul_display {
				mode = <0x0>;
				resolution = <0x140 0xf0>;
				size = <0x50 0x78>;
				timing,refresh = <0x3c>;
				timing,h-porch = <0x14 0x14 0x14>;
				timing,v-porch = <0x14 0x14 0x14>;
				timing,dsi-hs-clk = <0x258>;
				timing,pmsk = <0x1 0x60 0x2 0x0>;
				timing,dsi-escape-clk = <0x14>;
				underrun_lp_ref = <0x133>;
				mic_en = <0x0>;
				mic_ratio = <0x0>;
				mic_ver = <0x2>;
				type_of_ddi = <0x0>;
				dsc_en = <0x0>;
				dsc_cnt = <0x0>;
				dsc_slice_num = <0x0>;
				data_lane = <0x4>;
				cmd_underrun_lp_ref = <0x4b3>;
				vt_compensation = <0x29eb>;
				hdr_num = <0x0>;
				hdr_type = <0x0 0x0 0x0 0x0>;
				hdr_max_luma = <0x0>;
				hdr_max_avg_luma = <0x0>;
				hdr_min_luma = <0x0>;
				linux,phandle = <0x18>;
				phandle = <0x18>;
			};

			s6e3hf4_wqhd {
				mode = <0x2>;
				resolution = <0x5a0 0xa00>;
				size = <0x44 0x7a>;
				timing,refresh = <0x3c>;
				timing,h-porch = <0x2 0x2 0x2>;
				timing,v-porch = <0xf 0x3 0x1>;
				timing,dsi-hs-clk = <0x44c>;
				timing,pmsk = <0x4 0x2a5 0x2 0x0>;
				timing,dsi-escape-clk = <0x14>;
				mic_en = <0x0>;
				mic_ratio = <0x2>;
				mic_ver = <0x2>;
				type_of_ddi = <0x0>;
				dsc_en = <0x1>;
				dsc_cnt = <0x2>;
				dsc_slice_num = <0x4>;
				dsc_slice_h = <0x40>;
				data_lane = <0x4>;
				cmd_underrun_lp_ref = <0x15fd>;
				mres_en = <0x0>;
				mres_number = <0x1>;
				mres_width = <0x5a0 0x0 0x0>;
				mres_height = <0xa00 0x0 0x0>;
				mres_dsc_width = <0x168 0x0 0x0>;
				mres_dsc_height = <0x40 0x0 0x0>;
				mres_dsc_en = <0x1 0x0 0x0>;
				hdr_num = <0x1>;
				hdr_type = <0x2 0x0 0x0 0x0>;
				hdr_max_luma = <0x5265c0>;
				hdr_max_avg_luma = <0x124f80>;
				hdr_min_luma = <0x5>;
				linux,phandle = <0x19>;
				phandle = <0x19>;
			};

			s6e3ha2k_wqhd {
				mode = <0x2>;
				resolution = <0x5a0 0xa00>;
				size = <0x50 0x78>;
				timing,refresh = <0x3c>;
				timing,h-porch = <0x2 0x2 0x2>;
				timing,v-porch = <0x13 0x3 0x1>;
				timing,dsi-hs-clk = <0x44c>;
				timing,pmsk = <0x3 0x7f 0x0 0x0>;
				timing,dsi-escape-clk = <0x14>;
				mic_en = <0x1>;
				mic_ratio = <0x0>;
				mic_ver = <0x2>;
				type_of_ddi = <0x0>;
				dsc_en = <0x0>;
				dsc_cnt = <0x0>;
				dsc_slice_num = <0x0>;
				dsc_slice_h = <0x0>;
				data_lane = <0x4>;
				cmd_underrun_lp_ref = <0x4b3>;
				mres_en = <0x0>;
				mres_number = <0x1>;
				mres_width = <0x5a0 0x0 0x0>;
				mres_height = <0xa00 0x0 0x0>;
				mres_dsc_width = <0x0 0x0 0x0>;
				mres_dsc_height = <0x0 0x0 0x0>;
				mres_dsc_en = <0x0 0x0 0x0>;
				hdr_num = <0x1>;
				hdr_type = <0x2 0x0 0x0 0x0>;
				hdr_max_luma = <0x5265c0>;
				hdr_max_avg_luma = <0x124f80>;
				hdr_min_luma = <0x5>;
				linux,phandle = <0x1a>;
				phandle = <0x1a>;
			};

			s6e3ha3_wqhd {
				mode = <0x2>;
				resolution = <0x5a0 0xa00>;
				size = <0x46 0x79>;
				timing,refresh = <0x3c>;
				timing,h-porch = <0x2 0x2 0x2>;
				timing,v-porch = <0x13 0x3 0x1>;
				timing,dsi-hs-clk = <0x44c>;
				timing,pmsk = <0x3 0x7f 0x0 0x0>;
				timing,dsi-escape-clk = <0x14>;
				mic_en = <0x0>;
				mic_ratio = <0x2>;
				mic_ver = <0x2>;
				type_of_ddi = <0x0>;
				dsc_en = <0x1>;
				dsc_cnt = <0x1>;
				dsc_slice_num = <0x1>;
				dsc_slice_h = <0x20>;
				data_lane = <0x4>;
				cmd_underrun_lp_ref = <0x4b3>;
				mres_en = <0x0>;
				mres_number = <0x1>;
				mres_width = <0x5a0 0x0 0x0>;
				mres_height = <0xa00 0x0 0x0>;
				mres_dsc_width = <0x5a0 0x0 0x0>;
				mres_dsc_height = <0x20 0x0 0x0>;
				mres_dsc_en = <0x1 0x0 0x0>;
				hdr_num = <0x1>;
				hdr_type = <0x2 0x0 0x0 0x0>;
				hdr_max_luma = <0x5265c0>;
				hdr_max_avg_luma = <0x124f80>;
				hdr_min_luma = <0x5>;
				linux,phandle = <0x1b>;
				phandle = <0x1b>;
			};

			s6e3ha6_ddi {
				mode = <0x2>;
				resolution = <0x5a0 0xb90>;
				size = <0x45 0x8e>;
				timing,refresh = <0x3c>;
				timing,h-porch = <0x2 0x2 0x2>;
				timing,v-porch = <0xf 0x3 0x1>;
				timing,dsi-hs-clk = <0x382>;
				timing,pmsk = <0x5 0x2b3 0x2 0x0>;
				timing,dsi-escape-clk = <0x14>;
				mic_en = <0x0>;
				mic_ratio = <0x2>;
				mic_ver = <0x2>;
				type_of_ddi = <0x0>;
				dsc_en = <0x1>;
				dsc_cnt = <0x2>;
				dsc_slice_num = <0x2>;
				dsc_slice_h = <0x28>;
				data_lane = <0x4>;
				cmd_underrun_lp_ref = <0xbce>;
				mres_en = <0x1>;
				mres_number = <0x3>;
				mres_width = <0x5a0 0x438 0x2d0>;
				mres_height = <0xb90 0x8ac 0x5c8>;
				mres_dsc_width = <0x2d0 0x21c 0x168>;
				mres_dsc_height = <0x28 0x1e 0x4a>;
				mres_dsc_en = <0x1 0x1 0x0>;
				hdr_num = <0x1>;
				hdr_type = <0x2 0x0 0x0 0x0>;
				hdr_max_luma = <0x5265c0>;
				hdr_max_avg_luma = <0x124f80>;
				hdr_min_luma = <0x5>;
				linux,phandle = <0x1c>;
				phandle = <0x1c>;
			};

			s6e3fa0_fhd {
				mode = <0x2>;
				resolution = <0x438 0x780>;
				size = <0x46 0x79>;
				timing,refresh = <0x3c>;
				timing,h-porch = <0x2 0x2 0x2>;
				timing,v-porch = <0xa 0x3 0x1>;
				timing,dsi-hs-clk = <0x44c>;
				timing,pmsk = <0x3 0x7f 0x0 0x0>;
				timing,dsi-escape-clk = <0x14>;
				mic_en = <0x0>;
				mic_ratio = <0x2>;
				mic_ver = <0x0>;
				type_of_ddi = <0x0>;
				dsc_en = <0x0>;
				dsc_cnt = <0x0>;
				dsc_slice_num = <0x0>;
				dsc_slice_h = <0x28>;
				data_lane = <0x4>;
				cmd_underrun_lp_ref = <0xbce>;
				mres_en = <0x0>;
				mres_number = <0x3>;
				mres_width = <0x5a0 0x438 0x2d0>;
				mres_height = <0xb90 0x8ac 0x5c8>;
				mres_dsc_width = <0x2d0 0x21c 0x168>;
				mres_dsc_height = <0x28 0x1e 0x4a>;
				mres_dsc_en = <0x1 0x1 0x0>;
				hdr_num = <0x1>;
				hdr_type = <0x2 0x0 0x0 0x0>;
				hdr_max_luma = <0x5265c0>;
				hdr_max_avg_luma = <0x124f80>;
				hdr_min_luma = <0x5>;
				linux,phandle = <0x1d>;
				phandle = <0x1d>;
			};

			s6e3fa0_fhd_vid {
				mode = <0x0>;
				resolution = <0x438 0x780>;
				size = <0x50 0x78>;
				timing,refresh = <0x3c>;
				timing,h-porch = <0x14 0x14 0x14>;
				timing,v-porch = <0x2 0x14 0x2>;
				timing,dsi-hs-clk = <0x226>;
				timing,pmsk = <0x1 0xa9 0x3 0x0>;
				timing,dsi-escape-clk = <0x14>;
				mic_en = <0x0>;
				mic_ratio = <0x0>;
				mic_ver = <0x0>;
				type_of_ddi = <0x0>;
				dsc_en = <0x0>;
				dsc_cnt = <0x0>;
				dsc_slice_num = <0x0>;
				data_lane = <0x4>;
				cmd_underrun_lp_ref = <0x134e>;
				vt_compensation = <0x27>;
				mres_en = <0x0>;
				mres_number = <0x3>;
				mres_width = <0x5a0 0x438 0x2d0>;
				mres_height = <0xb90 0x8ac 0x5c8>;
				mres_dsc_width = <0x2d0 0x21c 0x168>;
				mres_dsc_height = <0x28 0x1e 0x4a>;
				mres_dsc_en = <0x1 0x1 0x0>;
				hdr_num = <0x1>;
				hdr_type = <0x2 0x0 0x0 0x0>;
				hdr_max_luma = <0x5265c0>;
				hdr_max_avg_luma = <0x124f80>;
				hdr_min_luma = <0x5>;
				linux,phandle = <0x1e>;
				phandle = <0x1e>;
			};

			s6e3fa7_fhd {
				mode = <0x2>;
				resolution = <0x438 0x8ac>;
				size = <0x43 0x8a>;
				timing,refresh = <0x3c>;
				timing,h-porch = <0x2 0x2 0x2>;
				timing,v-porch = <0xf 0x3 0x1>;
				timing,dsi-hs-clk = <0x44c>;
				timing,pmsk = <0x4 0x2a5 0x2 0x0>;
				timing,dsi-escape-clk = <0x14>;
				mic_en = <0x0>;
				mic_ratio = <0x0>;
				mic_ver = <0x0>;
				type_of_ddi = <0x0>;
				dsc_en = <0x0>;
				dsc_cnt = <0x0>;
				dsc_slice_num = <0x0>;
				data_lane = <0x4>;
				cmd_underrun_lp_ref = <0x9c2>;
				mres_en = <0x0>;
				mres_number = <0x3>;
				mres_width = <0x5a0 0x438 0x2d0>;
				mres_height = <0xb90 0x8ac 0x5c8>;
				mres_dsc_width = <0x2d0 0x21c 0x168>;
				mres_dsc_height = <0x28 0x1e 0x4a>;
				mres_dsc_en = <0x1 0x1 0x0>;
				hdr_num = <0x1>;
				hdr_type = <0x2 0x0 0x0 0x0>;
				hdr_max_luma = <0x5265c0>;
				hdr_max_avg_luma = <0x124f80>;
				hdr_min_luma = <0x5>;
				linux,phandle = <0x1f>;
				phandle = <0x1f>;
			};

			ea8076_fhd {
				mode = <0x2>;
				resolution = <0x438 0x924>;
				size = <0x44 0x93>;
				timing,refresh = <0x3c>;
				timing,h-porch = <0x2 0x2 0x2>;
				timing,v-porch = <0xf 0x3 0x1>;
				timing,dsi-hs-clk = <0x4b0>;
				timing,pmsk = <0x3 0x115 0x1 0x0>;
				timing,dsi-escape-clk = <0x14>;
				mic_en = <0x0>;
				mic_ratio = <0x0>;
				mic_ver = <0x0>;
				type_of_ddi = <0x0>;
				dsc_en = <0x0>;
				dsc_cnt = <0x0>;
				dsc_slice_num = <0x0>;
				data_lane = <0x4>;
				cmd_underrun_lp_ref = <0x81c>;
				mres_en = <0x0>;
				mres_number = <0x3>;
				mres_width = <0x5a0 0x438 0x2d0>;
				mres_height = <0xb90 0x8ac 0x5c8>;
				mres_dsc_width = <0x2d0 0x21c 0x168>;
				mres_dsc_height = <0x28 0x1e 0x4a>;
				mres_dsc_en = <0x1 0x1 0x0>;
				hdr_num = <0x1>;
				hdr_type = <0x2 0x0 0x0 0x0>;
				hdr_max_luma = <0x5265c0>;
				hdr_max_avg_luma = <0x124f80>;
				hdr_min_luma = <0x5>;
				linux,phandle = <0x11>;
				phandle = <0x11>;
			};
		};
	};

	fragment@model {
		target-path = [2f 00];

		__overlay__ {
			#address-cells = <0x2>;
			#size-cells = <0x1>;
			model = "Samsung UNIVERSAL9610 A50 Rev 0.1 board based on EXYNOS9610";

			ect {
				parameter_address = <0x90000000>;
				parameter_size = <0x19000>;
			};

			chosen {
				bootargs = "console=ram root=/dev/ram0 androidboot.boot_devices=13520000.ufs clk_ignore_unused bcm_setup=0xffffff80f8e00000 androidboot.hardware=exynos9610 androidboot.selinux=permissive androidboot.debug_level=0x4948 firmware_class.path=/vendor/firmware ecd_setup=disable reserve-fimc=0xffffff80fa000000 pmic_info=0x3";
				linux,initrd-start = <0x84000000>;
				linux,initrd-end = <0x841fffff>;
			};

			fixed-rate-clocks {

				oscclk {
					compatible = "samsung,exynos9610-oscclk";
					clock-frequency = <0x18cba80>;
				};
			};

			firmware {

				android {
					compatible = "android,firmware";

					vbmeta {
						compatible = "android,vbmeta";
						parts = "vbmeta,boot,system,vendor";
					};

					fstab {
						compatible = "android,fstab";

						vendor {
							compatible = "android,vendor";
							dev = "/dev/block/platform/13520000.ufs/by-name/vendor";
							type = "ext4";
							mnt_flags = "ro";
							fsmgr_flags = "wait,avb";
							status = "disabled";
						};
					};
				};
			};

			speedy@11a10000 {
				#address-cells = <0x1>;
				#size-cells = <0x0>;
				status = "okay";

				s2mpu09mfd@00 {
					compatible = "samsung,s2mpu09mfd";
					acpm-ipc-channel = <0x2>;
					i2c-speedy-address;
					s2mpu09,wakeup = "enabled";
					s2mpu09,irq-gpio = <0xffffffff 0x0 0x0>;
					reg = <0x0>;
					interrupts = <0x2 0x0 0x0>;
					interrupt-parent = <0xffffffff>;
					pinctrl-names = "default";
					pinctrl-0 = <0x2 0x3>;
					wtsr_en = "enabled";
					smpl_en = "enabled";
					wtsr_timer_val = <0x3>;
					smpl_timer_val = <0x4>;
					check_jigon = <0x0>;
					init_time,sec = <0x0>;
					init_time,min = <0x0>;
					init_time,hour = <0xc>;
					init_time,mday = <0x1>;
					init_time,mon = <0x0>;
					init_time,year = <0x75>;
					init_time,wday = <0x0>;

					regulators {

						BUCK1 {
							regulator-name = "vdd_mif";
							regulator-min-microvolt = <0x7a120>;
							regulator-max-microvolt = <0x10c8e0>;
							regulator-always-on;
							regulator-ramp-delay = <0x2ee0>;
							regulator-initial-mode = <0x2>;
							linux,phandle = <0x20>;
							phandle = <0x20>;
						};

						BUCK2 {
							regulator-name = "vdd_cpucl1";
							regulator-min-microvolt = <0x7a120>;
							regulator-max-microvolt = <0x13d620>;
							regulator-always-on;
							regulator-ramp-delay = <0x2ee0>;
							regulator-initial-mode = <0x1>;
							linux,phandle = <0x21>;
							phandle = <0x21>;
						};

						BUCK3 {
							regulator-name = "vdd_cpucl0";
							regulator-min-microvolt = <0x7a120>;
							regulator-max-microvolt = <0x13d620>;
							regulator-always-on;
							regulator-ramp-delay = <0x2ee0>;
							regulator-initial-mode = <0x1>;
							linux,phandle = <0x22>;
							phandle = <0x22>;
						};

						BUCK4 {
							regulator-name = "vdd_int";
							regulator-min-microvolt = <0x7a120>;
							regulator-max-microvolt = <0x10c8e0>;
							regulator-always-on;
							regulator-ramp-delay = <0x2ee0>;
							regulator-initial-mode = <0x2>;
							linux,phandle = <0x23>;
							phandle = <0x23>;
						};

						BUCK5 {
							regulator-name = "vdd_g3d";
							regulator-min-microvolt = <0x7a120>;
							regulator-max-microvolt = <0x124f80>;
							regulator-always-on;
							regulator-ramp-delay = <0x2ee0>;
							regulator-initial-mode = <0x2>;
							linux,phandle = <0x24>;
							phandle = <0x24>;
						};

						BUCK6 {
							regulator-name = "vdd_cam_vipx";
							regulator-min-microvolt = <0x7a120>;
							regulator-max-microvolt = <0x13d620>;
							regulator-always-on;
							regulator-ramp-delay = <0x2ee0>;
							regulator-initial-mode = <0x2>;
							linux,phandle = <0x25>;
							phandle = <0x25>;
						};

						BUCK7 {
							regulator-name = "vdd2_mem";
							regulator-min-microvolt = <0x7a120>;
							regulator-max-microvolt = <0x13d620>;
							regulator-always-on;
							regulator-ramp-delay = <0x2ee0>;
							regulator-initial-mode = <0x3>;
							linux,phandle = <0x26>;
							phandle = <0x26>;
						};

						BUCK8 {
							regulator-name = "vdd_lldo";
							regulator-min-microvolt = <0x124f80>;
							regulator-max-microvolt = <0x16e360>;
							regulator-always-on;
							regulator-ramp-delay = <0x2ee0>;
							regulator-initial-mode = <0x3>;
							linux,phandle = <0x27>;
							phandle = <0x27>;
						};

						BUCK9 {
							regulator-name = "vdd_mldo";
							regulator-min-microvolt = <0x1b7740>;
							regulator-max-microvolt = <0x200b20>;
							regulator-always-on;
							regulator-ramp-delay = <0x2ee0>;
							regulator-initial-mode = <0x3>;
							linux,phandle = <0x28>;
							phandle = <0x28>;
						};

						LDO1 {
							regulator-name = "vdd_ldo1";
							regulator-min-microvolt = <0xaae60>;
							regulator-max-microvolt = <0x13d620>;
							regulator-always-on;
							regulator-ramp-delay = <0x2ee0>;
							regulator-initial-mode = <0x3>;
							linux,phandle = <0x29>;
							phandle = <0x29>;
						};

						LDO2 {
							regulator-name = "vqmmc";
							regulator-min-microvolt = <0x1b7740>;
							regulator-max-microvolt = <0x337f98>;
							regulator-ramp-delay = <0x2ee0>;
							linux,phandle = <0x2a>;
							phandle = <0x2a>;
						};

						LDO3 {
							regulator-name = "vdd_ldo3";
							regulator-min-microvolt = <0xc3500>;
							regulator-max-microvolt = <0x1dc130>;
							regulator-always-on;
							regulator-ramp-delay = <0x2ee0>;
							regulator-initial-mode = <0x3>;
							linux,phandle = <0x2b>;
							phandle = <0x2b>;
						};

						LDO4 {
							regulator-name = "vdd_ldo4";
							regulator-min-microvolt = <0x7a120>;
							regulator-max-microvolt = <0x10c8e0>;
							regulator-always-on;
							regulator-ramp-delay = <0x2ee0>;
							regulator-initial-mode = <0x1>;
							linux,phandle = <0x2c>;
							phandle = <0x2c>;
						};

						LDO5 {
							regulator-name = "vdd_ldo5";
							regulator-min-microvolt = <0xc3500>;
							regulator-max-microvolt = <0x13d620>;
							regulator-always-on;
							regulator-ramp-delay = <0x2ee0>;
							regulator-initial-mode = <0x1>;
							linux,phandle = <0x2d>;
							phandle = <0x2d>;
						};

						LDO6 {
							regulator-name = "vdd_ldo6";
							regulator-min-microvolt = <0xc3500>;
							regulator-max-microvolt = <0x13d620>;
							regulator-always-on;
							regulator-ramp-delay = <0x2ee0>;
							regulator-initial-mode = <0x1>;
							linux,phandle = <0x2e>;
							phandle = <0x2e>;
						};

						LDO7 {
							regulator-name = "vdd_ldo7";
							regulator-min-microvolt = <0xc3500>;
							regulator-max-microvolt = <0x1dc130>;
							regulator-always-on;
							regulator-ramp-delay = <0x2ee0>;
							regulator-initial-mode = <0x1>;
							linux,phandle = <0x2f>;
							phandle = <0x2f>;
						};

						LDO8 {
							regulator-name = "vdd_ldo8";
							regulator-min-microvolt = <0x7a120>;
							regulator-max-microvolt = <0x13d620>;
							regulator-always-on;
							regulator-ramp-delay = <0x2ee0>;
							regulator-initial-mode = <0x1>;
							linux,phandle = <0x30>;
							phandle = <0x30>;
						};

						LDO9 {
							regulator-name = "vdd_ldo9";
							regulator-min-microvolt = <0x7a120>;
							regulator-max-microvolt = <0x13d620>;
							regulator-always-on;
							regulator-ramp-delay = <0x2ee0>;
							regulator-initial-mode = <0x1>;
							linux,phandle = <0x31>;
							phandle = <0x31>;
						};

						LDO10 {
							regulator-name = "vdd_ldo10";
							regulator-min-microvolt = <0x7a120>;
							regulator-max-microvolt = <0x13d620>;
							regulator-always-on;
							regulator-ramp-delay = <0x2ee0>;
							regulator-initial-mode = <0x1>;
							linux,phandle = <0x32>;
							phandle = <0x32>;
						};

						LDO11 {
							regulator-name = "vdd_ldo11";
							regulator-min-microvolt = <0x7a120>;
							regulator-max-microvolt = <0x13d620>;
							regulator-always-on;
							regulator-ramp-delay = <0x2ee0>;
							regulator-initial-mode = <0x3>;
							linux,phandle = <0x33>;
							phandle = <0x33>;
						};

						LDO12 {
							regulator-name = "vdd_ldo12";
							regulator-min-microvolt = <0xc3500>;
							regulator-max-microvolt = <0x13d620>;
							regulator-always-on;
							regulator-ramp-delay = <0x2ee0>;
							regulator-initial-mode = <0x3>;
							linux,phandle = <0x34>;
							phandle = <0x34>;
						};

						LDO13 {
							regulator-name = "vdd_ldo13";
							regulator-min-microvolt = <0xc3500>;
							regulator-max-microvolt = <0x1dc130>;
							regulator-always-on;
							regulator-ramp-delay = <0x2ee0>;
							regulator-initial-mode = <0x3>;
							linux,phandle = <0x35>;
							phandle = <0x35>;
						};

						LDO14 {
							regulator-name = "vdd_ldo14";
							regulator-min-microvolt = <0x1b7740>;
							regulator-max-microvolt = <0x337f98>;
							regulator-always-on;
							regulator-ramp-delay = <0x2ee0>;
							regulator-initial-mode = <0x3>;
							linux,phandle = <0x36>;
							phandle = <0x36>;
						};

						LDO33 {
							regulator-name = "vdd_ldo33";
							regulator-min-microvolt = <0xc3500>;
							regulator-max-microvolt = <0x1dc130>;
							regulator-ramp-delay = <0x2ee0>;
							linux,phandle = <0x37>;
							phandle = <0x37>;
						};

						LDO34 {
							regulator-name = "vdd_ldo34";
							regulator-min-microvolt = <0x1b7740>;
							regulator-max-microvolt = <0x337f98>;
							regulator-ramp-delay = <0x2ee0>;
							linux,phandle = <0x38>;
							phandle = <0x38>;
						};

						LDO35 {
							regulator-name = "vmmc";
							regulator-min-microvolt = <0x1b7740>;
							regulator-max-microvolt = <0x337f98>;
							regulator-ramp-delay = <0x2ee0>;
							linux,phandle = <0x39>;
							phandle = <0x39>;
						};

						LDO36 {
							regulator-name = "vdd_ldo36";
							regulator-min-microvolt = <0x7a120>;
							regulator-max-microvolt = <0x13d620>;
							regulator-always-on;
							regulator-ramp-delay = <0x2ee0>;
							regulator-initial-mode = <0x1>;
							linux,phandle = <0x3a>;
							phandle = <0x3a>;
						};

						LDO37 {
							regulator-name = "vdd_ldo37";
							regulator-min-microvolt = <0x1b7740>;
							regulator-max-microvolt = <0x337f98>;
							regulator-ramp-delay = <0x2ee0>;
							linux,phandle = <0x3b>;
							phandle = <0x3b>;
						};

						LDO38 {
							regulator-name = "vdd_ldo38";
							regulator-min-microvolt = <0x1b7740>;
							regulator-max-microvolt = <0x337f98>;
							regulator-ramp-delay = <0x2ee0>;
							regulator-always-on;
							linux,phandle = <0x3c>;
							phandle = <0x3c>;
						};

						LDO39 {
							regulator-name = "vdd_ldo39";
							regulator-min-microvolt = <0x1b7740>;
							regulator-max-microvolt = <0x1b7740>;
							regulator-initial-mode = <0x3>;
							linux,phandle = <0x3d>;
							phandle = <0x3d>;
						};

						LDO40 {
							regulator-name = "vdd_ldo40";
							regulator-min-microvolt = <0x325aa0>;
							regulator-max-microvolt = <0x325aa0>;
							regulator-initial-mode = <0x3>;
							regulator-always-on;
							linux,phandle = <0x14>;
							phandle = <0x14>;
						};

						LDO41 {
							regulator-name = "vdd_ldo41";
							regulator-min-microvolt = <0x1b7740>;
							regulator-max-microvolt = <0x337f98>;
							regulator-ramp-delay = <0x2ee0>;
							linux,phandle = <0x3e>;
							phandle = <0x3e>;
						};

						LDO42 {
							regulator-name = "vdd_ldo42";
							regulator-min-microvolt = <0xc3500>;
							regulator-max-microvolt = <0x1dc130>;
							regulator-ramp-delay = <0x2ee0>;
							regulator-always-on;
							linux,phandle = <0x13>;
							phandle = <0x13>;
						};

						LDO43 {
							regulator-name = "vdd_ldo43";
							regulator-min-microvolt = <0x7a120>;
							regulator-max-microvolt = <0x13d620>;
							regulator-always-on;
							regulator-ramp-delay = <0x2ee0>;
							regulator-initial-mode = <0x1>;
							linux,phandle = <0x3f>;
							phandle = <0x3f>;
						};

						LDO44 {
							regulator-name = "vdd_ldo44";
							regulator-min-microvolt = <0xc3500>;
							regulator-max-microvolt = <0x13d620>;
							regulator-ramp-delay = <0x2ee0>;
							linux,phandle = <0x40>;
							phandle = <0x40>;
						};
					};
				};
			};

			exynos_rgt {
				compatible = "samsung,exynos-rgt";
			};

			mcu_ipc@11920000 {
				compatible = "samsung,exynos-shd-ipc-mailbox";
				reg = <0x0 0x11920000 0x180>;
				mcu,name = "mcu_ipc_cp";
				mcu,id = <0x0>;
				interrupts = <0x0 0x28 0x0>;
				linux,phandle = <0x41>;
				phandle = <0x41>;
			};

			mif_pdata {
				gpios = <0xffffffff 0x3 0x0 0xffffffff 0x4 0x0 0xffffffff 0x5 0x0>;
				pinctrl-names = "default";
			};

			mcu_ipc@11A00000 {
				compatible = "samsung,exynos-shd-ipc-mailbox";
				reg = <0x0 0x11a00000 0x180>;
				mcu,name = "mcu_ipc_gnss";
				mcu,id = <0x1>;
				interrupts = <0x0 0x2b 0x0>;
				linux,phandle = <0x4>;
				phandle = <0x4>;
			};

			gnss_pdata {
				status = "okay";
				compatible = "samsung,gnss_shdmem_if";
				shmem,name = "KEPLER";
				shmem,device_node_name = "gnss_ipc";
				interrupts = <0x0 0x1b 0x0 0x0 0x51 0x0 0x0 0x50 0x0 0x0 0x4f 0x0>;
				interrupt-names = "ACTIVE", "WATCHDOG", "WAKEUP", "REQ_INIT";
				memory-region = <0xffffffff>;
				mbox_info = <0x4>;
				mbx,int_ap2gnss_bcmd = <0x0>;
				mbx,int_ap2gnss_req_fault_info = <0x1>;
				mbx,int_ap2gnss_ipc_msg = <0x2>;
				mbx,int_ap2gnss_ack_wake_set = <0x3>;
				mbx,int_ap2gnss_ack_wake_clr = <0x4>;
				mbx,irq_gnss2ap_bcmd = <0x0>;
				mbx,irq_gnss2ap_rsp_fault_info = <0x1>;
				mbx,irq_gnss2ap_ipc_msg = <0x2>;
				mbx,irq_gnss2ap_req_wake_clr = <0x4>;
				mbx,reg_bcmd_ctrl = <0x0 0x1 0x2 0x3>;
				reg_rx_ipc_msg = <0x1 0x5>;
				reg_tx_ipc_msg = <0x1 0x4>;
				reg_rx_head = <0x1 0x3>;
				reg_rx_tail = <0x1 0x2>;
				reg_tx_head = <0x1 0x1>;
				reg_tx_tail = <0x1 0x0>;
				fault_info = <0x1 0x200000 0x180000>;
				shmem,ipc_offset = <0x380000>;
				shmem,ipc_size = <0x80000>;
				shmem,ipc_reg_cnt = <0x20>;
			};

			gpio_keys {
				#address-cells = <0x1>;
				#size-cells = <0x0>;
				compatible = "gpio-keys";
				status = "okay";
				pinctrl-names = "default";
				pinctrl-0 = <0x5 0x6 0x7>;

				button@1 {
					label = "gpio-keys: KEY_VOLUMEDOWN";
					linux,code = <0x72>;
					gpios = <0xffffffff 0x6 0xf>;
				};

				button@2 {
					label = "gpio-keys: KEY_VOLUMEUP";
					linux,code = <0x73>;
					gpios = <0xffffffff 0x5 0xf>;
				};

				button@3 {
					label = "gpio-keys: KEY_POWER";
					linux,code = <0x74>;
					gpios = <0xffffffff 0x7 0xf>;
					gpio-key,wakeup = <0x1>;
				};
			};

			tsp_ldo_en {
				compatible = "regulator-fixed";
				regulator-name = "tsp_ldo_en";
				regulator-min-microvolt = <0x2dc6c0>;
				regulator-max-microvolt = <0x2dc6c0>;
				gpio = <0xffffffff 0x1 0x0>;
				enable-active-high;
			};

			i2c@13870000 {
				status = "okay";
				samsung,i2c-sda-delay = <0x64>;
				samsung,i2c-max-bus-freq = <0x61a80>;
				#address-cells = <0x1>;
				#size-cells = <0x0>;
				linux,phandle = <0x42>;
				phandle = <0x42>;

				mms_ts@48 {
					compatible = "melfas,mms_ts";
					reg = <0x48>;
					pinctrl-names = "on_state", "off_state";
					pinctrl-0 = <0x8>;
					pinctrl-1 = <0x9>;
					melfas,vdd_en = "tsp_ldo_en";
					melfas,irq-gpio = <0xffffffff 0x0 0x0>;
					melfas,scl-gpio = <0xffffffff 0x1 0x0>;
					melfas,sda-gpio = <0xffffffff 0x0 0x0>;
					melfas,area-size = <0x85 0x10a 0x155>;
					melfas,support_lpm = "true";
					melfas,fw_name = "tsp_melfas/mss100_a50.fw";
					melfas,project_name = "A505";
					melfas,bringup = <0x3>;
				};
			};

			usb_notifier {
				compatible = "samsung,usb-notifier";
				udc = <0xffffffff>;
			};

			fixedregulator@1 {
				compatible = "regulator-fixed";
				regulator-name = "V_SYS";
				regulator-min-microvolt = <0x401640>;
				regulator-max-microvolt = <0x401640>;
				regulator-boot-on;
				regulator-always-on;
				linux,phandle = <0x43>;
				phandle = <0x43>;
			};

			audio_codec_dummy {
				status = "okay";
				compatible = "snd-soc-dummy";
				linux,phandle = <0xa>;
				phandle = <0xa>;
			};

			audio_cpu_dummy {
				compatible = "samsung,dummy-cpu";
				status = "okay";
				linux,phandle = <0x44>;
				phandle = <0x44>;
			};

			sound {
				status = "okay";
				compatible = "samsung,exynos9610-audio";
				clock-names = "xclkout";
				clocks = <0xffffffff 0x321>;
				pinctrl-names = "default";
				pinctrl-0 = <0xffffffff>;
				samsung,routing = "HEADSETMIC", "MICBIAS1", "MAINMIC", "MICBIAS2", "SUBMIC", "MICBIAS3", "IN1P", "HEADSETMIC", "IN1N", "HEADSETMIC", "IN3P", "MAINMIC", "IN3N", "MAINMIC", "IN4P", "SUBMIC", "IN4N", "SUBMIC", "RECEIVER", "MONOOUT", "RECEIVER", "MONOOUT", "HEADPHONE", "HPOL", "HEADPHONE", "HPOR", "VOUTPUT", "ABOX UAIF0 Playback", "SPEAKER", "ABOX UAIF2 Playback", "VOUTPUTCALL", "ABOX SIFS0 Playback", "BLUETOOTH SPK", "ABOX SIFS2 Playback", "ABOX SIFS2 Capture", "BLUETOOTH MIC", "ABOX SIFS0 Capture", "VINPUTCALL";
				samsung,codec = <0xffffffff 0xffffffff 0xffffffff 0xffffffff 0xffffffff 0xffffffff 0xffffffff>;
				samsung,prefix = "ABOX", "ABOX", "ABOX", "ABOX", "ABOX", "ABOX", "ABOX";
				samsung,aux = <0xffffffff 0xffffffff>;

				rdma@0 {

					cpu {
						sound-dai = <0xffffffff 0x0>;
					};

					platform {
						sound-dai = <0xffffffff>;
					};

					codec {
						sound-dai = <0xa>;
					};
				};

				rdma@1 {

					cpu {
						sound-dai = <0xffffffff 0x1>;
					};

					platform {
						sound-dai = <0xffffffff>;
					};

					codec {
						sound-dai = <0xa>;
					};
				};

				rdma@2 {

					cpu {
						sound-dai = <0xffffffff 0x2>;
					};

					platform {
						sound-dai = <0xffffffff>;
					};

					codec {
						sound-dai = <0xa>;
					};
				};

				rdma@3 {

					cpu {
						sound-dai = <0xffffffff 0x3>;
					};

					platform {
						sound-dai = <0xffffffff>;
					};

					codec {
						sound-dai = <0xa>;
					};
				};

				rdma@4 {

					cpu {
						sound-dai = <0xffffffff 0x4>;
					};

					platform {
						sound-dai = <0xffffffff>;
					};

					codec {
						sound-dai = <0xa>;
					};
				};

				rdma@5 {

					cpu {
						sound-dai = <0xffffffff 0x5>;
					};

					platform {
						sound-dai = <0xffffffff>;
					};

					codec {
						sound-dai = <0xa>;
					};
				};

				rdma@6 {

					cpu {
						sound-dai = <0xffffffff 0x6>;
					};

					platform {
						sound-dai = <0xffffffff>;
					};

					codec {
						sound-dai = <0xa>;
					};
				};

				rdma@7 {

					cpu {
						sound-dai = <0xffffffff 0x7>;
					};

					platform {
						sound-dai = <0xffffffff>;
					};

					codec {
						sound-dai = <0xa>;
					};
				};

				wdma@0 {

					cpu {
						sound-dai = <0xffffffff 0x8>;
					};

					platform {
						sound-dai = <0xffffffff>;
					};

					codec {
						sound-dai = <0xa>;
					};
				};

				wdma@1 {

					cpu {
						sound-dai = <0xffffffff 0x9>;
					};

					platform {
						sound-dai = <0xffffffff>;
					};

					codec {
						sound-dai = <0xa>;
					};
				};

				wdma@2 {

					cpu {
						sound-dai = <0xffffffff 0xa>;
					};

					platform {
						sound-dai = <0xffffffff>;
					};

					codec {
						sound-dai = <0xa>;
					};
				};

				wdma@3 {

					cpu {
						sound-dai = <0xffffffff 0xb>;
					};

					platform {
						sound-dai = <0xffffffff>;
					};

					codec {
						sound-dai = <0xa>;
					};
				};

				wdma@4 {

					cpu {
						sound-dai = <0xffffffff 0xc>;
					};

					platform {
						sound-dai = <0xffffffff>;
					};

					codec {
						sound-dai = <0xa>;
					};
				};

				uaif@0 {
					format = "i2s";

					cpu {
						sound-dai = <0xffffffff>;
					};

					codec {
						sound-dai = <0xb 0x0>;
					};
				};

				uaif@1 {
					format = "i2s";

					cpu {
						sound-dai = <0xffffffff>;
					};

					codec {
						sound-dai = <0xa>;
					};
				};

				uaif@2 {
					format = "i2s";

					cpu {
						sound-dai = <0xffffffff>;
					};

					platform {
						sound-dai = <0xffffffff 0x0>;
					};

					codec {
						sound-dai = <0xc 0x0>;
					};
				};

				uaif@4 {
					format = "i2s";
					bitclock-master;
					frame-master;

					cpu {
						sound-dai = <0xffffffff>;
					};

					codec {
						sound-dai = <0xa>;
					};
				};

				dsif@0 {
					format = "pdm";

					cpu {
						sound-dai = <0xffffffff>;
					};

					codec {
						sound-dai = <0xa>;
					};
				};

				spdy@0 {

					cpu {
						sound-dai = <0xffffffff>;
					};

					codec {
						sound-dai = <0xa>;
					};
				};

				sifs0@0 {

					cpu {
						sound-dai = <0xffffffff 0xd>;
					};

					codec {
						sound-dai = <0xa>;
					};
				};

				sifs1@0 {

					cpu {
						sound-dai = <0xffffffff 0xe>;
					};

					codec {
						sound-dai = <0xa>;
					};
				};

				sifs2@0 {

					cpu {
						sound-dai = <0xffffffff 0xf>;
					};

					codec {
						sound-dai = <0xa>;
					};
				};
			};

			dwmmc2@13550000 {
				status = "okay";
				num-slots = <0x1>;
				supports-4bit;
				supports-cmd23;
				supports-erase;
				supports-highspeed;
				sd-uhs-sdr50;
				sd-uhs-sdr104;
				card-detect-gpio;
				bypass-for-allpass;
				card-init-hwacg-ctrl;
				skip-init-mmc-scan;
				card-detect-invert;
				qos-dvfs-int-level = <0x82208>;
				qos-dvfs-mif-level = <0xa50a0>;
				fifo-depth = <0x40>;
				desc-size = <0x4>;
				ssc-rate = <0x3>;
				card-detect-delay = <0xc8>;
				data-timeout = <0xc8>;
				hto-timeout = <0x50>;
				samsung,dw-mshc-ciu-div = <0x3>;
				clock-frequency = <0x2faf0800>;
				samsung,dw-mshc-sdr-timing = <0x3 0x0 0x2 0x0>;
				samsung,dw-mshc-ddr-timing = <0x3 0x0 0x2 0x1>;
				samsung,dw-mshc-sdr50-timing = <0x3 0x0 0x4 0x2>;
				samsung,dw-mshc-sdr104-timing = <0x3 0x0 0x3 0x0>;
				num-ref-clks = <0x9>;
				ciu_clkin = <0x19 0x32 0x32 0x19 0x32 0x64 0xc8 0x32 0x32>;
				clk-drive-number = <0x4>;
				pinctrl-names = "default", "fast-slew-rate-1x", "fast-slew-rate-2x", "fast-slew-rate-3x", "fast-slew-rate-4x";
				pinctrl-0 = <0xffffffff 0xffffffff 0xffffffff 0xffffffff 0xd>;
				pinctrl-1 = <0xffffffff>;
				pinctrl-2 = <0xffffffff>;
				pinctrl-3 = <0xffffffff>;
				pinctrl-4 = <0xffffffff>;
				card-detect = <0xffffffff 0x4 0xf>;
				#address-cells = <0x1>;
				#size-cells = <0x0>;

				slot@0 {
					reg = <0x0>;
					bus-width = <0x4>;
					disable-wp;
				};
			};

			usb_hs_tune {
				hs_tune_cnt = <0xc>;
				linux,phandle = <0xe>;
				phandle = <0xe>;

				hs_tune1 {
					tune_name = "tx_vref";
					tune_value = <0xf 0xf>;
				};

				hs_tune2 {
					tune_name = "tx_pre_emp";
					tune_value = <0x3 0x3>;
				};

				hs_tune3 {
					tune_name = "tx_pre_emp_plus";
					tune_value = <0x0 0x0>;
				};

				hs_tune4 {
					tune_name = "tx_res";
					tune_value = <0x3 0x3>;
				};

				hs_tune5 {
					tune_name = "tx_rise";
					tune_value = <0x3 0x3>;
				};

				hs_tune6 {
					tune_name = "tx_hsxv";
					tune_value = <0x3 0x3>;
				};

				hs_tune7 {
					tune_name = "tx_fsls";
					tune_value = <0x3 0x3>;
				};

				hs_tune8 {
					tune_name = "rx_sqrx";
					tune_value = <0x7 0x7>;
				};

				hs_tune9 {
					tune_name = "compdis";
					tune_value = <0x7 0x7>;
				};

				hs_tune10 {
					tune_name = "otg";
					tune_value = <0x2 0x2>;
				};

				hs_tune11 {
					tune_name = "enable_user_imp";
					tune_value = <0x0 0x0>;
				};

				hs_tune12 {
					tune_name = "is_phyclock";
					tune_value = <0x1 0x1>;
				};
			};

			ufs-srpmb {
				compatible = "samsung,ufs-srpmb";
				interrupts = <0x0 0x1cc 0x0>;
			};

			usb3_ss_tune {
				ss_tune_cnt = <0xf>;
				linux,phandle = <0x10>;
				phandle = <0x10>;

				ss_tune1 {
					tune_name = "tx0_term_offset";
					tune_value = <0x0 0x0>;
				};

				ss_tune2 {
					tune_name = "pcs_tx_swing_full";
					tune_value = <0x7f 0x7f>;
				};

				ss_tune3 {
					tune_name = "pcs_tx_deemph_6db";
					tune_value = <0x1c 0x1c>;
				};

				ss_tune4 {
					tune_name = "pcs_tx_deemph_3p5db";
					tune_value = <0x1c 0x1c>;
				};

				ss_tune5 {
					tune_name = "tx_vboost_lvl_sstx";
					tune_value = <0x7 0x7>;
				};

				ss_tune6 {
					tune_name = "tx_vboost_lvl";
					tune_value = <0x4 0x4>;
				};

				ss_tune7 {
					tune_name = "los_level";
					tune_value = <0x9 0x9>;
				};

				ss_tune8 {
					tune_name = "los_bias";
					tune_value = <0x5 0x5>;
				};

				ss_tune9 {
					tune_name = "pcs_rx_los_mask_val";
					tune_value = <0x104 0x104>;
				};

				ss_tune10 {
					tune_name = "tx_eye_height_cntl_en";
					tune_value = <0x1 0x1>;
				};

				ss_tune11 {
					tune_name = "pipe_tx_deemph_update_delay";
					tune_value = <0x2 0x2>;
				};

				ss_tune12 {
					tune_name = "pcs_tx_swing_full_sstx";
					tune_value = <0x7f 0x7f>;
				};

				ss_tune13 {
					tune_name = "rx_eq_fix_val";
					tune_value = <0x2 0x2>;
				};

				ss_tune14 {
					tune_name = "rx_decode_mode";
					tune_value = <0x1 0x1>;
				};

				ss_tune15 {
					tune_name = "decrese_ss_tx_imp";
					tune_value = <0x1 0x1>;
				};
			};

			usb3_hs_tune {
				hs_tune_cnt = <0xa>;
				linux,phandle = <0xf>;
				phandle = <0xf>;

				hs_tune1 {
					tune_name = "tx_pre_emp";
					tune_value = <0x3 0x3>;
				};

				hs_tune2 {
					tune_name = "tx_pre_emp_plus";
					tune_value = <0x0 0x0>;
				};

				hs_tune3 {
					tune_name = "tx_vref";
					tune_value = <0x7 0x7>;
				};

				hs_tune4 {
					tune_name = "rx_sqrx";
					tune_value = <0x7 0x7>;
				};

				hs_tune5 {
					tune_name = "tx_rise";
					tune_value = <0x3 0x3>;
				};

				hs_tune6 {
					tune_name = "compdis";
					tune_value = <0x7 0x7>;
				};

				hs_tune7 {
					tune_name = "tx_hsxv";
					tune_value = <0x3 0x3>;
				};

				hs_tune8 {
					tune_name = "tx_fsls";
					tune_value = <0x3 0x3>;
				};

				hs_tune9 {
					tune_name = "tx_res";
					tune_value = <0x3 0x3>;
				};

				hs_tune10 {
					tune_name = "utim_clk";
					tune_value = <0x1 0x1>;
				};
			};

			fimc-is-flash-gpio@0 {
				compatible = "samsung,sensor-flash-gpio";
				id = <0x0>;
				status = "okay";
				torch-gpio = <0xffffffff 0x3 0x1>;
				flash-gpio = <0xffffffff 0x6 0x1>;
				linux,phandle = <0x45>;
				phandle = <0x45>;
			};

			fimc-is_sensor_2p8@20 {
				compatible = "samsung,sensor-module-2p8";
				pinctrl-names = "pin0", "pin1", "pin2", "release";
				pinctrl-0;
				pinctrl-1 = <0xffffffff>;
				pinctrl-2 = <0xffffffff>;
				pinctrl-3;
				position = <0x0>;
				id = <0x0>;
				mclk_ch = <0x0>;
				sensor_i2c_ch = <0x0>;
				gpio_mclk = <0xffffffff 0x0 0x1>;
				gpio_reset = <0xffffffff 0x1 0x1>;
				gpio_ldos_en = <0xffffffff 0x1 0x1>;
				power_seq_id = <0x1>;
				status = "okay";
				linux,phandle = <0x46>;
				phandle = <0x46>;

				af {
					product_name = <0x7>;
					i2c_ch = <0x2>;
				};

				flash {
					product_name = <0xb>;
				};
			};

			fimc-is_sensor_3h1@31 {
				compatible = "samsung,sensor-module-3h1";
				pinctrl-names = "pin0", "pin1", "pin2", "release";
				pinctrl-0;
				pinctrl-1 = <0xffffffff>;
				pinctrl-2 = <0xffffffff>;
				pinctrl-3;
				position = <0x1>;
				id = <0x1>;
				mclk_ch = <0x1>;
				sensor_i2c_ch = <0x1>;
				gpio_mclk = <0xffffffff 0x1 0x1>;
				gpio_reset = <0xffffffff 0x7 0x1>;
				gpio_ldos_en = <0xffffffff 0x0 0x1>;
				power_seq_id = <0x1>;
				status = "okay";
				linux,phandle = <0x47>;
				phandle = <0x47>;

				af {
					product_name = <0x12>;
					i2c_ch = <0x3>;
				};

				flash {
					product_name = <0x64>;
				};

				ois {
					product_name = <0x64>;
				};

				internal_vc {
				};
			};
		};
	};

	fragment@3 {
		target = <0xffffffff>;

		__overlay__ {
			status = "okay";

			dwc3 {
				dr_mode = "otg";
				maximum-speed = "high-speed";
			};
		};
	};

	fragment@4 {
		target = <0xffffffff>;

		__overlay__ {
			dr_mode = "otg";
			maximum-speed = "high-speed";
			usb_audio_offloading = <0x1>;
			abox = <0xffffffff>;
		};
	};

	fragment@5 {
		target = <0xffffffff>;

		__overlay__ {
			status = "okay";
			usb3phy-isolation = <0x1>;
			hs_tune_param = <0xe>;
		};
	};

	fragment@6 {
		target = <0xffffffff>;

		__overlay__ {
			status = "okay";
			usb3phy-isolation = <0x1>;
			hs_tune_param = <0xf>;
			ss_tune_param = <0x10>;
		};
	};

	fragment@7 {
		target = <0xffffffff>;

		__overlay__ {
			status = "okay";
		};
	};

	fragment@8 {
		target = <0xffffffff>;

		__overlay__ {

			spk-reset {
				samsung,pins = "gpm24-0";
				samsung,pin-pud = <0x0>;
				linux,phandle = <0x48>;
				phandle = <0x48>;
			};

			amp-irq {
				samsung,pins = "gpm25-0";
				samsung,pin-function = <0xf>;
				samsung,pin-pud = <0x0>;
				linux,phandle = <0x49>;
				phandle = <0x49>;
			};
		};
	};

	fragment@9 {
		target = <0xffffffff>;

		__overlay__ {

			key-voldown {
				samsung,pins = "gpa1-6";
				samsung,pin-function = <0xf>;
				samsung,pin-pud = <0x0>;
				samsung,pin-drv = <0x0>;
				linux,phandle = <0x5>;
				phandle = <0x5>;
			};

			key-volup {
				samsung,pins = "gpa1-5";
				samsung,pin-function = <0xf>;
				samsung,pin-pud = <0x0>;
				samsung,pin-drv = <0x0>;
				linux,phandle = <0x6>;
				phandle = <0x6>;
			};

			key-power {
				samsung,pins = "gpa1-7";
				samsung,pin-function = <0xf>;
				samsung,pin-pud = <0x0>;
				samsung,pin-drv = <0x0>;
				linux,phandle = <0x7>;
				phandle = <0x7>;
			};

			attn-irq {
				samsung,pins = "gpa0-0";
				samsung,pin-function = <0xf>;
				samsung,pin-pud = <0x0>;
				samsung,pin-drv = <0x0>;
				linux,phandle = <0x8>;
				phandle = <0x8>;
			};

			attn-input {
				samsung,pins = "gpa0-0";
				samsung,pin-function = <0x0>;
				samsung,pin-pud = <0x1>;
				linux,phandle = <0x9>;
				phandle = <0x9>;
			};

			if-pmic-irq {
				samsung,pins = "gpa2-2";
				samsung,pin-function = <0x0>;
				samsung,pin-pud = <0x0>;
				samsung,pin-drv = <0x0>;
				linux,phandle = <0x16>;
				phandle = <0x16>;
			};

			pmic-irq {
				samsung,pins = "gpa2-0";
				samsung,pin-pud = <0x3>;
				samsung,pin-drv = <0x3>;
				linux,phandle = <0x2>;
				phandle = <0x2>;
			};

			codec_irq {
				samsung,pins = "gpa1-2";
				samsung,pin-function = <0xf>;
				samsung,pin-pud = <0x0>;
				linux,phandle = <0x12>;
				phandle = <0x12>;
			};

			dwmmc2_cd_ext_irq {
				samsung,pins = "gpa2-4";
				samsung,pin-function = <0xf>;
				samsung,pin-pud = <0x0>;
				samsung,pin-drv = <0x3>;
				linux,phandle = <0xd>;
				phandle = <0xd>;
			};
		};
	};

	fragment@10 {
		target = <0xffffffff>;

		__overlay__ {

			pm-wrsti {
				samsung,pins = "gpg0-7";
				samsung,pin-con-pdn = <0x3>;
				linux,phandle = <0x3>;
				phandle = <0x3>;
			};
		};
	};

	fragment@11 {
		target = <0xffffffff>;

		__overlay__ {
			exynos,block-type = "sda";
			exynos,fips-block_offset = <0x5>;
		};
	};

	fragment@12 {
		target = <0xffffffff>;

		__overlay__ {
			lcd_info = <0x11>;
			gpios = <0xffffffff 0x3 0x1 0xffffffff 0x2 0x1 0xffffffff 0x4 0x1>;
		};
	};

	fragment@13 {
		target = <0xffffffff>;

		__overlay__ {
			status = "disabled";
		};
	};

	fragment@14 {
		target = <0xffffffff>;

		__overlay__ {
			status = "disabled";
		};
	};

	fragment@15 {
		target = <0xffffffff>;

		__overlay__ {
			usi_v2_mode = "spi";
			status = "okay";
		};
	};

	fragment@16 {
		target = <0xffffffff>;

		__overlay__ {
			status = "disabled";
		};
	};

	fragment@17 {
		target = <0xffffffff>;

		__overlay__ {
			status = "disabled";
		};
	};

	fragment@18 {
		target = <0xffffffff>;

		__overlay__ {
			usi_v2_mode = "i2c";
			status = "okay";
		};
	};

	fragment@19 {
		target = <0xffffffff>;

		__overlay__ {
			usi_v2_mode = "i2c";
			status = "okay";
		};
	};

	fragment@20 {
		target = <0xffffffff>;

		__overlay__ {
			status = "disabled";
		};
	};

	fragment@21 {
		target = <0xffffffff>;

		__overlay__ {
			usi_v2_mode = "i2c";
			status = "okay";
		};
	};

	fragment@22 {
		target = <0xffffffff>;

		__overlay__ {
			status = "disabled";
		};
	};

	fragment@23 {
		target = <0xffffffff>;

		__overlay__ {
			usi_v2_mode = "spi";
			status = "okay";
		};
	};

	fragment@24 {
		target = <0xffffffff>;

		__overlay__ {
			status = "disabled";
		};
	};

	fragment@25 {
		target = <0xffffffff>;

		__overlay__ {
			status = "disabled";
		};
	};

	fragment@26 {
		target = <0xffffffff>;

		__overlay__ {
			status = "disabled";
		};
	};

	fragment@27 {
		target = <0xffffffff>;

		__overlay__ {
			usi_v2_mode = "spi";
			status = "okay";
		};
	};

	fragment@28 {
		target = <0xffffffff>;

		__overlay__ {
			chub-irq-pin-len = <0x1>;
			chub-irq-pin = <0xffffffff 0x0 0x0>;
			clocks = <0xffffffff 0x258 0xffffffff 0x79 0xffffffff 0x7b 0xffffffff 0x7d>;
			clock-names = "chub_bus", "cmgp_usi01", "cmgp_usi03", "cmgp_i2c";
		};
	};

	fragment@29 {
		target = <0xffffffff>;

		__overlay__ {

			vender {
				rear_sensor_id = <0x14>;
				front_sensor_id = <0x1f>;
				rear_second_sensor_id = <0x0>;
				secure_sensor_id = <0x0>;
			};

			fimc_is_dvfs {

				table0 {
					desc = "dvfs table v0.0 for 16M/8M";
					default_int_cam = <0xa8750>;
					default_cam = <0xa8750>;
					default_mif = <0x1fefc8>;
					default_int = <0x186a0>;
					default_hpg = <0x1>;
					front_preview_int_cam = <0xa8750>;
					front_preview_cam = <0xa8750>;
					front_preview_mif = <0x1fefc8>;
					front_preview_int = <0x186a0>;
					front_preview_hpg = <0x1>;
					front_preview_full_int_cam = <0xa8750>;
					front_preview_full_cam = <0xa8750>;
					front_preview_full_mif = <0x1fefc8>;
					front_preview_full_int = <0x186a0>;
					front_preview_full_hpg = <0x1>;
					front_capture_int_cam = <0xa8750>;
					front_capture_cam = <0xa8750>;
					front_capture_mif = <0x1fefc8>;
					front_capture_int = <0x186a0>;
					front_capture_hpg = <0x1>;
					front_video_int_cam = <0xa8750>;
					front_video_cam = <0xa8750>;
					front_video_mif = <0x1fefc8>;
					front_video_int = <0x186a0>;
					front_video_hpg = <0x1>;
					front_video_capture_int_cam = <0xa8750>;
					front_video_capture_cam = <0xa8750>;
					front_video_capture_mif = <0x1fefc8>;
					front_video_capture_int = <0x186a0>;
					front_video_capture_hpg = <0x1>;
					front_wide_selfie_int_cam = <0xa8750>;
					front_wide_selfie_cam = <0xa8750>;
					front_wide_selfie_mif = <0x1fefc8>;
					front_wide_selfie_int = <0x186a0>;
					front_wide_selfie_hpg = <0x1>;
					front_vt1_int_cam = <0xa8750>;
					front_vt1_cam = <0xa8750>;
					front_vt1_mif = <0x1fefc8>;
					front_vt1_int = <0x186a0>;
					front_vt1_hpg = <0x1>;
					front_vt2_int_cam = <0xa8750>;
					front_vt2_cam = <0xa8750>;
					front_vt2_mif = <0x1fefc8>;
					front_vt2_int = <0x186a0>;
					front_vt2_hpg = <0x1>;
					front_vt4_int_cam = <0xa8750>;
					front_vt4_cam = <0xa8750>;
					front_vt4_mif = <0x1fefc8>;
					front_vt4_int = <0x186a0>;
					front_vt4_hpg = <0x1>;
					rear_preview_fhd_int_cam = <0xa8750>;
					rear_preview_fhd_cam = <0xa8750>;
					rear_preview_fhd_mif = <0x1fefc8>;
					rear_preview_fhd_int = <0x186a0>;
					rear_preview_fhd_hpg = <0x1>;
					rear_preview_hd_int_cam = <0xa8750>;
					rear_preview_hd_cam = <0xa8750>;
					rear_preview_hd_mif = <0x1fefc8>;
					rear_preview_hd_int = <0x186a0>;
					rear_preview_hd_hpg = <0x1>;
					rear_preview_uhd_int_cam = <0xa8750>;
					rear_preview_uhd_cam = <0xa8750>;
					rear_preview_uhd_mif = <0x1fefc8>;
					rear_preview_uhd_int = <0x186a0>;
					rear_preview_uhd_hpg = <0x1>;
					rear_preview_full_int_cam = <0xa8750>;
					rear_preview_full_cam = <0xa8750>;
					rear_preview_full_mif = <0x1fefc8>;
					rear_preview_full_int = <0x186a0>;
					rear_preview_full_hpg = <0x1>;
					rear_capture_int_cam = <0xa8750>;
					rear_capture_cam = <0xa8750>;
					rear_capture_mif = <0x1fefc8>;
					rear_capture_int = <0x186a0>;
					rear_capture_hpg = <0x1>;
					rear_video_fhd_int_cam = <0xa8750>;
					rear_video_fhd_cam = <0xa8750>;
					rear_video_fhd_mif = <0x1fefc8>;
					rear_video_fhd_int = <0x186a0>;
					rear_video_fhd_hpg = <0x1>;
					rear_video_hd_int_cam = <0xa8750>;
					rear_video_hd_cam = <0xa8750>;
					rear_video_hd_mif = <0x1fefc8>;
					rear_video_hd_int = <0x186a0>;
					rear_video_hd_hpg = <0x1>;
					rear_video_uhd_int_cam = <0xa8750>;
					rear_video_uhd_cam = <0xa8750>;
					rear_video_uhd_mif = <0x1fefc8>;
					rear_video_uhd_int = <0x186a0>;
					rear_video_uhd_hpg = <0x1>;
					rear_video_fhd_capture_int_cam = <0xa8750>;
					rear_video_fhd_capture_cam = <0xa8750>;
					rear_video_fhd_capture_mif = <0x1fefc8>;
					rear_video_fhd_capture_int = <0x186a0>;
					rear_video_fhd_capture_hpg = <0x1>;
					rear_video_hd_capture_int_cam = <0xa8750>;
					rear_video_hd_capture_cam = <0xa8750>;
					rear_video_hd_capture_mif = <0x1fefc8>;
					rear_video_hd_capture_int = <0x186a0>;
					rear_video_hd_capture_hpg = <0x1>;
					rear_video_uhd_capture_int_cam = <0xa8750>;
					rear_video_uhd_capture_cam = <0xa8750>;
					rear_video_uhd_capture_mif = <0x1fefc8>;
					rear_video_uhd_capture_int = <0x186a0>;
					rear_video_uhd_capture_hpg = <0x1>;
					secure_front_int_cam = <0xa8750>;
					secure_front_cam = <0xa8750>;
					secure_front_mif = <0x1fefc8>;
					secure_front_int = <0x186a0>;
					secure_front_hpg = <0x1>;
					pip_preview_int_cam = <0xa8750>;
					pip_preview_cam = <0xa8750>;
					pip_preview_mif = <0x1fefc8>;
					pip_preview_int = <0x186a0>;
					pip_preview_hpg = <0x1>;
					pip_capture_int_cam = <0xa8750>;
					pip_capture_cam = <0xa8750>;
					pip_capture_mif = <0x1fefc8>;
					pip_capture_int = <0x186a0>;
					pip_capture_hpg = <0x1>;
					pip_video_int_cam = <0xa8750>;
					pip_video_cam = <0xa8750>;
					pip_video_mif = <0x1fefc8>;
					pip_video_int = <0x186a0>;
					pip_video_hpg = <0x1>;
					pip_video_capture_int_cam = <0xa8750>;
					pip_video_capture_cam = <0xa8750>;
					pip_video_capture_mif = <0x1fefc8>;
					pip_video_capture_int = <0x186a0>;
					pip_video_capture_hpg = <0x1>;
					preview_high_speed_fps_int_cam = <0xa8750>;
					preview_high_speed_fps_cam = <0xa8750>;
					preview_high_speed_fps_mif = <0x1fefc8>;
					preview_high_speed_fps_int = <0x186a0>;
					preview_high_speed_fps_hpg = <0x1>;
					video_high_speed_60fps_int_cam = <0xa8750>;
					video_high_speed_60fps_cam = <0xa8750>;
					video_high_speed_60fps_mif = <0x1fefc8>;
					video_high_speed_60fps_int = <0x186a0>;
					video_high_speed_60fps_hpg = <0x1>;
					video_high_speed_480fps_int_cam = <0xa8750>;
					video_high_speed_480fps_cam = <0xa8750>;
					video_high_speed_480fps_mif = <0x1fefc8>;
					video_high_speed_480fps_int = <0xa2d78>;
					video_high_speed_480fps_hpg = <0x1>;
					video_high_speed_60fps_capture_int_cam = <0xa8750>;
					video_high_speed_60fps_capture_cam = <0xa8750>;
					video_high_speed_60fps_capture_mif = <0x1fefc8>;
					video_high_speed_60fps_capture_int = <0x186a0>;
					video_high_speed_60fps_capture_hpg = <0x1>;
					ext_front_int_cam = <0xa8750>;
					ext_front_cam = <0xa8750>;
					ext_front_mif = <0x1fefc8>;
					ext_front_int = <0x186a0>;
					ext_front_hpg = <0x1>;
					ext_secure_int_cam = <0xa8750>;
					ext_secure_cam = <0xa8750>;
					ext_secure_mif = <0x1fefc8>;
					ext_secure_int = <0x186a0>;
					ext_secure_hpg = <0x1>;
					max_int_cam = <0xa8750>;
					max_cam = <0xa8750>;
					max_mif = <0x1fefc8>;
					max_int = <0xa2d78>;
					max_hpg = <0x1>;
				};
			};
		};
	};

	fragment@30 {
		target = <0xffffffff>;

		__overlay__ {
			scenario = <0x0>;
			id = <0x0>;
			csi_ch = <0x0>;
			dma_ch = <0x0 0x0 0x0 0x0 0x0 0x1 0x1 0x1>;
			vc_ch = <0x0 0x1 0x2 0x3 0x0 0x1 0x2 0x3>;
			flite_ch = <0x64>;
			is_bns = <0x0>;
			status = "okay";
		};
	};

	fragment@31 {
		target = <0xffffffff>;

		__overlay__ {
			scenario = <0x0>;
			id = <0x2>;
			csi_ch = <0x1>;
			dma_ch = <0x2 0x2 0x2 0x2 0x2 0x1 0x1 0x1>;
			vc_ch = <0x0 0x1 0x2 0x3 0x1 0x2 0x1 0x3>;
			flite_ch = <0x64>;
			is_bns = <0x0>;
			status = "okay";
		};
	};

	fragment@32 {
		target = <0xffffffff>;

		__overlay__ {
			scenario = <0x0>;
			id = <0x1>;
			csi_ch = <0x2>;
			dma_ch = <0x2 0x2 0x2 0x2>;
			vc_ch = <0x0 0x1 0x2 0x3>;
			flite_ch = <0x64>;
			is_bns = <0x0>;
			status = "okay";
		};
	};

	fragment@33 {
		target = <0xffffffff>;

		__overlay__ {
			scenario = <0x6>;
			id = <0x3>;
			csi_ch = <0x3>;
			dma_ch = <0x3 0x3 0x3 0x3>;
			vc_ch = <0x0 0x1 0x2 0x3>;
			flite_ch = <0x64>;
			is_bns = <0x0>;
			status = "okay";
		};
	};

	fragment@34 {
		target = <0xffffffff>;

		__overlay__ {
			#address-cells = <0x1>;
			#size-cells = <0x0>;
			status = "okay";

			rt5665@1b {
				compatible = "realtek,rt5665";
				reg = <0x1b>;
				pinctrl-names = "default";
				pinctrl-0 = <0x12>;
				interrupt-parent = <0xffffffff>;
				interrupts = <0x2 0x0 0x0>;
				#sound-dai-cells = <0x1>;
				realtek,in1-differential;
				realtek,in3-differential;
				realtek,in4-differential;
				realtek,jd-src = <0x2>;
				realtek,dmic2-data-pin = <0x2>;
				realtek,sar-hs-type = <0x266>;
				realtek,sar-pb-vth0 = <0x6e>;
				realtek,sar-pb-vth1 = <0x87>;
				realtek,sar-pb-vth2 = <0xff>;
				realtek,sar-pb-vth3 = <0x2bc>;
				imp_table = <0x0 0xd 0x0 0x6 0xe 0x19 0x0 0x6 0x1a 0x35 0x0 0x6 0x36 0x67 0x0 0x1 0x68 0xffff 0x0 0x1>;
				realtek,regulator_1v8 = <0x13>;
				realtek,regulator_3v3 = <0x14>;
				linux,phandle = <0xb>;
				phandle = <0xb>;
			};
		};
	};

	fragment@35 {
		target = <0xffffffff>;

		__overlay__ {
			#address-cells = <0x1>;
			#size-cells = <0x0>;
			gpios = <0xffffffff 0x0 0x0 0xffffffff 0x1 0x0>;
			status = "okay";
			clock-frequency = <0x61a80>;
			samsung,reset-before-trans;
			samsung,polling-mode;

			fimc-is-2p8@2d {
				compatible = "samsung,exynos5-fimc-is-cis-2p8";
				reg = <0x2d>;
				id = <0x0>;
				setfile = "setA";
			};
		};
	};

	fragment@36 {
		target = <0xffffffff>;

		__overlay__ {
			#address-cells = <0x1>;
			#size-cells = <0x0>;
			gpios = <0xffffffff 0x2 0x0 0xffffffff 0x3 0x0>;
			status = "okay";
			clock-frequency = <0x61a80>;
			samsung,reset-before-trans;

			fimc-is-3h1@35 {
				compatible = "samsung,exynos5-fimc-is-cis-3h1";
				reg = <0x35>;
				id = <0x1>;
				setfile = "setA";
			};
		};
	};

	fragment@37 {
		target = <0xffffffff>;

		__overlay__ {
			#address-cells = <0x1>;
			#size-cells = <0x0>;
			gpios = <0xffffffff 0x4 0x0 0xffffffff 0x5 0x0>;
			status = "okay";
			clock-frequency = <0x61a80>;
			samsung,reset-before-trans;

			fimc-is-actuator@0C {
				compatible = "samsung,exynos5-fimc-is-actuator-ak7345";
				reg = <0xc>;
				id = <0x0>;
			};
		};
	};

	fragment@38 {
		target = <0xffffffff>;

		__overlay__ {
			#address-cells = <0x1>;
			#size-cells = <0x0>;
			gpios = <0xffffffff 0x6 0x0 0xffffffff 0x7 0x0>;
			status = "okay";
			clock-frequency = <0x61a80>;
			samsung,reset-before-trans;

			fimc-is-actuator@0F {
				compatible = "samsung,exynos5-fimc-is-actuator-ak737x";
				reg = <0xc>;
				id = <0x1>;
				vendor_product_id = <0x3 0xc>;
				vendor_first_pos = <0x78>;
				vendor_first_delay = <0x2710>;
			};
		};
	};

	fragment@39 {
		target = <0xffffffff>;

		__overlay__ {
			#address-cells = <0x1>;
			#size-cells = <0x0>;
			status = "okay";
			samsung,fix-doxfer-return;
			samsung,glitch-filter;

			sm5713@49 {
				compatible = "siliconmitus,sm5713mfd";
				reg = <0x49>;
				pinctrl-names = "default";
				pinctrl-0 = <0x15 0x16>;
				sm5713,irq-gpio = <0xffffffff 0x2 0x0>;
				sm5713,wakeup;
			};
		};
	};

	fragment@40 {
		target = <0xffffffff>;

		__overlay__ {
			#address-cells = <0x1>;
			#size-cells = <0x0>;
			status = "okay";

			tfa98xx@34 {
				compatible = "nxp,tfa98xx";
				#sound-dai-cells = <0x1>;
				reg = <0x34>;
				linux,phandle = <0xc>;
				phandle = <0xc>;
			};
		};
	};

	__symbols__ {
		usbpd_irq = "/fragment@0/__overlay__/usbpd-irq";
		chg_en = "/fragment@1/__overlay__/chg-en";
		shmem = "/fragment@modemif/__overlay__/shmem@F0000000";
		emul_display = "/fragment@lcd/__overlay__/emul_display";
		s6e3hf4 = "/fragment@lcd/__overlay__/s6e3hf4_wqhd";
		s6e3ha2k = "/fragment@lcd/__overlay__/s6e3ha2k_wqhd";
		s6e3ha3 = "/fragment@lcd/__overlay__/s6e3ha3_wqhd";
		s6e3ha6 = "/fragment@lcd/__overlay__/s6e3ha6_ddi";
		s6e3fa0 = "/fragment@lcd/__overlay__/s6e3fa0_fhd";
		s6e3fa0_vid = "/fragment@lcd/__overlay__/s6e3fa0_fhd_vid";
		s6e3fa7 = "/fragment@lcd/__overlay__/s6e3fa7_fhd";
		ea8076 = "/fragment@lcd/__overlay__/ea8076_fhd";
		b1_reg = "/fragment@model/__overlay__/speedy@11a10000/s2mpu09mfd@00/regulators/BUCK1";
		b2_reg = "/fragment@model/__overlay__/speedy@11a10000/s2mpu09mfd@00/regulators/BUCK2";
		b3_reg = "/fragment@model/__overlay__/speedy@11a10000/s2mpu09mfd@00/regulators/BUCK3";
		b4_reg = "/fragment@model/__overlay__/speedy@11a10000/s2mpu09mfd@00/regulators/BUCK4";
		b5_reg = "/fragment@model/__overlay__/speedy@11a10000/s2mpu09mfd@00/regulators/BUCK5";
		b6_reg = "/fragment@model/__overlay__/speedy@11a10000/s2mpu09mfd@00/regulators/BUCK6";
		b7_reg = "/fragment@model/__overlay__/speedy@11a10000/s2mpu09mfd@00/regulators/BUCK7";
		b8_reg = "/fragment@model/__overlay__/speedy@11a10000/s2mpu09mfd@00/regulators/BUCK8";
		b9_reg = "/fragment@model/__overlay__/speedy@11a10000/s2mpu09mfd@00/regulators/BUCK9";
		l1_reg = "/fragment@model/__overlay__/speedy@11a10000/s2mpu09mfd@00/regulators/LDO1";
		l2_reg = "/fragment@model/__overlay__/speedy@11a10000/s2mpu09mfd@00/regulators/LDO2";
		l3_reg = "/fragment@model/__overlay__/speedy@11a10000/s2mpu09mfd@00/regulators/LDO3";
		l4_reg = "/fragment@model/__overlay__/speedy@11a10000/s2mpu09mfd@00/regulators/LDO4";
		l5_reg = "/fragment@model/__overlay__/speedy@11a10000/s2mpu09mfd@00/regulators/LDO5";
		l6_reg = "/fragment@model/__overlay__/speedy@11a10000/s2mpu09mfd@00/regulators/LDO6";
		l7_reg = "/fragment@model/__overlay__/speedy@11a10000/s2mpu09mfd@00/regulators/LDO7";
		l8_reg = "/fragment@model/__overlay__/speedy@11a10000/s2mpu09mfd@00/regulators/LDO8";
		l9_reg = "/fragment@model/__overlay__/speedy@11a10000/s2mpu09mfd@00/regulators/LDO9";
		l10_reg = "/fragment@model/__overlay__/speedy@11a10000/s2mpu09mfd@00/regulators/LDO10";
		l11_reg = "/fragment@model/__overlay__/speedy@11a10000/s2mpu09mfd@00/regulators/LDO11";
		l12_reg = "/fragment@model/__overlay__/speedy@11a10000/s2mpu09mfd@00/regulators/LDO12";
		l13_reg = "/fragment@model/__overlay__/speedy@11a10000/s2mpu09mfd@00/regulators/LDO13";
		l14_reg = "/fragment@model/__overlay__/speedy@11a10000/s2mpu09mfd@00/regulators/LDO14";
		l33_reg = "/fragment@model/__overlay__/speedy@11a10000/s2mpu09mfd@00/regulators/LDO33";
		l34_reg = "/fragment@model/__overlay__/speedy@11a10000/s2mpu09mfd@00/regulators/LDO34";
		l35_reg = "/fragment@model/__overlay__/speedy@11a10000/s2mpu09mfd@00/regulators/LDO35";
		l36_reg = "/fragment@model/__overlay__/speedy@11a10000/s2mpu09mfd@00/regulators/LDO36";
		l37_reg = "/fragment@model/__overlay__/speedy@11a10000/s2mpu09mfd@00/regulators/LDO37";
		l38_reg = "/fragment@model/__overlay__/speedy@11a10000/s2mpu09mfd@00/regulators/LDO38";
		l39_reg = "/fragment@model/__overlay__/speedy@11a10000/s2mpu09mfd@00/regulators/LDO39";
		l40_reg = "/fragment@model/__overlay__/speedy@11a10000/s2mpu09mfd@00/regulators/LDO40";
		l41_reg = "/fragment@model/__overlay__/speedy@11a10000/s2mpu09mfd@00/regulators/LDO41";
		l42_reg = "/fragment@model/__overlay__/speedy@11a10000/s2mpu09mfd@00/regulators/LDO42";
		l43_reg = "/fragment@model/__overlay__/speedy@11a10000/s2mpu09mfd@00/regulators/LDO43";
		l44_reg = "/fragment@model/__overlay__/speedy@11a10000/s2mpu09mfd@00/regulators/LDO44";
		mailbox_cp = "/fragment@model/__overlay__/mcu_ipc@11920000";
		mailbox_gnss = "/fragment@model/__overlay__/mcu_ipc@11A00000";
		i2c_4 = "/fragment@model/__overlay__/i2c@13870000";
		V_SYS = "/fragment@model/__overlay__/fixedregulator@1";
		dummy_audio_codec = "/fragment@model/__overlay__/audio_codec_dummy";
		dummy_audio_cpu = "/fragment@model/__overlay__/audio_cpu_dummy";
		usb_hs_tune = "/fragment@model/__overlay__/usb_hs_tune";
		usb3_ss_tune = "/fragment@model/__overlay__/usb3_ss_tune";
		usb3_hs_tune = "/fragment@model/__overlay__/usb3_hs_tune";
		fimc_is_flash_gpio = "/fragment@model/__overlay__/fimc-is-flash-gpio@0";
		fimc_is_sensor_2p8 = "/fragment@model/__overlay__/fimc-is_sensor_2p8@20";
		fimc_is_sensor_3h1 = "/fragment@model/__overlay__/fimc-is_sensor_3h1@31";
		spk_reset = "/fragment@8/__overlay__/spk-reset";
		amp_irq = "/fragment@8/__overlay__/amp-irq";
		key_voldown = "/fragment@9/__overlay__/key-voldown";
		key_volup = "/fragment@9/__overlay__/key-volup";
		key_power = "/fragment@9/__overlay__/key-power";
		attn_irq = "/fragment@9/__overlay__/attn-irq";
		attn_input = "/fragment@9/__overlay__/attn-input";
		if_pmic_irq = "/fragment@9/__overlay__/if-pmic-irq";
		pmic_irq = "/fragment@9/__overlay__/pmic-irq";
		codec_irq = "/fragment@9/__overlay__/codec_irq";
		dwmmc2_cd_ext_irq = "/fragment@9/__overlay__/dwmmc2_cd_ext_irq";
		pm_wrsti = "/fragment@10/__overlay__/pm-wrsti";
		rt5665 = "/fragment@34/__overlay__/rt5665@1b";
		tfa98xx = "/fragment@40/__overlay__/tfa98xx@34";
	};

	__fixups__ {
		exynos_adc = "/fragment@battery/__overlay__/battery:io-channels:0", "/fragment@battery/__overlay__/battery:io-channels:8", "/fragment@battery/__overlay__/battery:io-channels:16";
		pinctrl_0 = "/fragment@0:target:0", "/fragment@9:target:0";
		pinctrl_4 = "/fragment@1:target:0", "/fragment@10:target:0";
		i2c_0 = "/fragment@2:target:0";
		gpa2 = "/fragment@2/__overlay__/usbpd-5713@33:usbpd,usbpd_int:0", "/fragment@model/__overlay__/speedy@11a10000/s2mpu09mfd@00:s2mpu09,irq-gpio:0", "/fragment@model/__overlay__/speedy@11a10000/s2mpu09mfd@00:interrupt-parent:0", "/fragment@model/__overlay__/dwmmc2@13550000:card-detect:0", "/fragment@39/__overlay__/sm5713@49:sm5713,irq-gpio:0";
		gpg3 = "/fragment@model/__overlay__/mif_pdata:gpios:0", "/fragment@model/__overlay__/mif_pdata:gpios:12", "/fragment@model/__overlay__/mif_pdata:gpios:24", "/fragment@model/__overlay__/tsp_ldo_en:gpio:0";
		gnss_reserved = "/fragment@model/__overlay__/gnss_pdata:memory-region:0";
		gpa1 = "/fragment@model/__overlay__/gpio_keys/button@1:gpios:0", "/fragment@model/__overlay__/gpio_keys/button@2:gpios:0", "/fragment@model/__overlay__/gpio_keys/button@3:gpios:0", "/fragment@model/__overlay__/fimc-is-flash-gpio@0:torch-gpio:0", "/fragment@34/__overlay__/rt5665@1b:interrupt-parent:0";
		gpa0 = "/fragment@model/__overlay__/i2c@13870000/mms_ts@48:melfas,irq-gpio:0";
		gpp1 = "/fragment@model/__overlay__/i2c@13870000/mms_ts@48:melfas,scl-gpio:0", "/fragment@model/__overlay__/i2c@13870000/mms_ts@48:melfas,sda-gpio:0";
		udc = "/fragment@model/__overlay__/usb_notifier:udc:0", "/fragment@3:target:0";
		clock = "/fragment@model/__overlay__/sound:clocks:0", "/fragment@28/__overlay__:clocks:0", "/fragment@28/__overlay__:clocks:8", "/fragment@28/__overlay__:clocks:16", "/fragment@28/__overlay__:clocks:24";
		xclkout0 = "/fragment@model/__overlay__/sound:pinctrl-0:0";
		abox = "/fragment@model/__overlay__/sound:samsung,codec:0", "/fragment@model/__overlay__/sound/rdma@0/cpu:sound-dai:0", "/fragment@model/__overlay__/sound/rdma@1/cpu:sound-dai:0", "/fragment@model/__overlay__/sound/rdma@2/cpu:sound-dai:0", "/fragment@model/__overlay__/sound/rdma@3/cpu:sound-dai:0", "/fragment@model/__overlay__/sound/rdma@4/cpu:sound-dai:0", "/fragment@model/__overlay__/sound/rdma@5/cpu:sound-dai:0", "/fragment@model/__overlay__/sound/rdma@6/cpu:sound-dai:0", "/fragment@model/__overlay__/sound/rdma@7/cpu:sound-dai:0", "/fragment@model/__overlay__/sound/wdma@0/cpu:sound-dai:0", "/fragment@model/__overlay__/sound/wdma@1/cpu:sound-dai:0", "/fragment@model/__overlay__/sound/wdma@2/cpu:sound-dai:0", "/fragment@model/__overlay__/sound/wdma@3/cpu:sound-dai:0", "/fragment@model/__overlay__/sound/wdma@4/cpu:sound-dai:0", "/fragment@model/__overlay__/sound/sifs0@0/cpu:sound-dai:0", "/fragment@model/__overlay__/sound/sifs1@0/cpu:sound-dai:0", "/fragment@model/__overlay__/sound/sifs2@0/cpu:sound-dai:0", "/fragment@4/__overlay__:abox:0";
		abox_uaif_0 = "/fragment@model/__overlay__/sound:samsung,codec:4", "/fragment@model/__overlay__/sound/uaif@0/cpu:sound-dai:0";
		abox_uaif_1 = "/fragment@model/__overlay__/sound:samsung,codec:8", "/fragment@model/__overlay__/sound/uaif@1/cpu:sound-dai:0";
		abox_uaif_2 = "/fragment@model/__overlay__/sound:samsung,codec:12", "/fragment@model/__overlay__/sound/uaif@2/cpu:sound-dai:0";
		abox_uaif_4 = "/fragment@model/__overlay__/sound:samsung,codec:16", "/fragment@model/__overlay__/sound/uaif@4/cpu:sound-dai:0";
		abox_dsif = "/fragment@model/__overlay__/sound:samsung,codec:20", "/fragment@model/__overlay__/sound/dsif@0/cpu:sound-dai:0";
		abox_spdy = "/fragment@model/__overlay__/sound:samsung,codec:24", "/fragment@model/__overlay__/sound/spdy@0/cpu:sound-dai:0";
		abox_effect = "/fragment@model/__overlay__/sound:samsung,aux:0";
		abox_bt = "/fragment@model/__overlay__/sound:samsung,aux:4";
		abox_rdma_0 = "/fragment@model/__overlay__/sound/rdma@0/platform:sound-dai:0";
		abox_rdma_1 = "/fragment@model/__overlay__/sound/rdma@1/platform:sound-dai:0";
		abox_rdma_2 = "/fragment@model/__overlay__/sound/rdma@2/platform:sound-dai:0";
		abox_rdma_3 = "/fragment@model/__overlay__/sound/rdma@3/platform:sound-dai:0";
		abox_rdma_4 = "/fragment@model/__overlay__/sound/rdma@4/platform:sound-dai:0";
		abox_rdma_5 = "/fragment@model/__overlay__/sound/rdma@5/platform:sound-dai:0";
		abox_rdma_6 = "/fragment@model/__overlay__/sound/rdma@6/platform:sound-dai:0";
		abox_rdma_7 = "/fragment@model/__overlay__/sound/rdma@7/platform:sound-dai:0";
		abox_wdma_0 = "/fragment@model/__overlay__/sound/wdma@0/platform:sound-dai:0";
		abox_wdma_1 = "/fragment@model/__overlay__/sound/wdma@1/platform:sound-dai:0";
		abox_wdma_2 = "/fragment@model/__overlay__/sound/wdma@2/platform:sound-dai:0";
		abox_wdma_3 = "/fragment@model/__overlay__/sound/wdma@3/platform:sound-dai:0";
		abox_wdma_4 = "/fragment@model/__overlay__/sound/wdma@4/platform:sound-dai:0";
		abox_synchronized_ipc = "/fragment@model/__overlay__/sound/uaif@2/platform:sound-dai:0";
		sd2_clk = "/fragment@model/__overlay__/dwmmc2@13550000:pinctrl-0:0";
		sd2_cmd = "/fragment@model/__overlay__/dwmmc2@13550000:pinctrl-0:4";
		sd2_bus1 = "/fragment@model/__overlay__/dwmmc2@13550000:pinctrl-0:8";
		sd2_bus4 = "/fragment@model/__overlay__/dwmmc2@13550000:pinctrl-0:12";
		sd2_clk_fast_slew_rate_1x = "/fragment@model/__overlay__/dwmmc2@13550000:pinctrl-1:0";
		sd2_clk_fast_slew_rate_2x = "/fragment@model/__overlay__/dwmmc2@13550000:pinctrl-2:0";
		sd2_clk_fast_slew_rate_3x = "/fragment@model/__overlay__/dwmmc2@13550000:pinctrl-3:0";
		sd2_clk_fast_slew_rate_4x = "/fragment@model/__overlay__/dwmmc2@13550000:pinctrl-4:0";
		gpg0 = "/fragment@model/__overlay__/fimc-is-flash-gpio@0:flash-gpio:0";
		fimc_is_mclk0_out = "/fragment@model/__overlay__/fimc-is_sensor_2p8@20:pinctrl-1:0";
		fimc_is_mclk0_fn = "/fragment@model/__overlay__/fimc-is_sensor_2p8@20:pinctrl-2:0";
		gpc2 = "/fragment@model/__overlay__/fimc-is_sensor_2p8@20:gpio_mclk:0", "/fragment@model/__overlay__/fimc-is_sensor_3h1@31:gpio_mclk:0";
		gpg1 = "/fragment@model/__overlay__/fimc-is_sensor_2p8@20:gpio_reset:0", "/fragment@model/__overlay__/fimc-is_sensor_3h1@31:gpio_reset:0", "/fragment@12/__overlay__:gpios:0", "/fragment@12/__overlay__:gpios:12";
		gpc1 = "/fragment@model/__overlay__/fimc-is_sensor_2p8@20:gpio_ldos_en:0", "/fragment@model/__overlay__/fimc-is_sensor_3h1@31:gpio_ldos_en:0";
		fimc_is_mclk1_out = "/fragment@model/__overlay__/fimc-is_sensor_3h1@31:pinctrl-1:0";
		fimc_is_mclk1_fn = "/fragment@model/__overlay__/fimc-is_sensor_3h1@31:pinctrl-2:0";
		usbdrd_dwc3 = "/fragment@4:target:0";
		usbdrd_phy = "/fragment@5:target:0";
		usbdrd3_phy = "/fragment@6:target:0";
		serial_0 = "/fragment@7:target:0";
		pinctrl_1 = "/fragment@8:target:0";
		fmp_0 = "/fragment@11:target:0";
		dsim_0 = "/fragment@12:target:0";
		gpg2 = "/fragment@12/__overlay__:gpios:24";
		usi_0_shub = "/fragment@13:target:0";
		usi_0_shub_i2c = "/fragment@14:target:0";
		usi_0_cmgp = "/fragment@15:target:0";
		usi_0_cmgp_i2c = "/fragment@16:target:0";
		usi_1_cmgp = "/fragment@17:target:0";
		usi_1_cmgp_i2c = "/fragment@18:target:0";
		usi_2_cmgp = "/fragment@19:target:0";
		usi_2_cmgp_i2c = "/fragment@20:target:0";
		usi_3_cmgp = "/fragment@21:target:0";
		usi_3_cmgp_i2c = "/fragment@22:target:0";
		usi_4_cmgp = "/fragment@23:target:0";
		usi_4_cmgp_i2c = "/fragment@24:target:0";
		usi_peri_usi_0 = "/fragment@25:target:0";
		usi_peri_usi_0_i2c = "/fragment@26:target:0";
		usi_peri_spi_1 = "/fragment@27:target:0";
		contexthub_0 = "/fragment@28:target:0";
		gpm8 = "/fragment@28/__overlay__:chub-irq-pin:0";
		fimc_is = "/fragment@29:target:0";
		fimc_is_sensor0 = "/fragment@30:target:0";
		fimc_is_sensor1 = "/fragment@31:target:0";
		fimc_is_sensor2 = "/fragment@32:target:0";
		fimc_is_sensor3 = "/fragment@33:target:0";
		i2c_6 = "/fragment@34:target:0";
		hsi2c_12 = "/fragment@35:target:0";
		gpc0 = "/fragment@35/__overlay__:gpios:0", "/fragment@35/__overlay__:gpios:12", "/fragment@36/__overlay__:gpios:0", "/fragment@36/__overlay__:gpios:12", "/fragment@37/__overlay__:gpios:0", "/fragment@37/__overlay__:gpios:12", "/fragment@38/__overlay__:gpios:0", "/fragment@38/__overlay__:gpios:12";
		hsi2c_13 = "/fragment@36:target:0";
		hsi2c_14 = "/fragment@37:target:0";
		hsi2c_15 = "/fragment@38:target:0";
		i2c_1 = "/fragment@39:target:0";
		hsi2c_3 = "/fragment@40:target:0";
	};

	__local_fixups__ {

		fragment@2 {

			__overlay__ {

				usbpd-5713@33 {
					pinctrl-0 = <0x0>;
				};
			};
		};

		fragment@model {

			__overlay__ {

				speedy@11a10000 {

					s2mpu09mfd@00 {
						pinctrl-0 = <0x0 0x4>;
					};
				};

				gnss_pdata {
					mbox_info = <0x0>;
				};

				gpio_keys {
					pinctrl-0 = <0x0 0x4 0x8>;
				};

				i2c@13870000 {

					mms_ts@48 {
						pinctrl-0 = <0x0>;
						pinctrl-1 = <0x0>;
					};
				};

				sound {

					rdma@0 {

						codec {
							sound-dai = <0x0>;
						};
					};

					rdma@1 {

						codec {
							sound-dai = <0x0>;
						};
					};

					rdma@2 {

						codec {
							sound-dai = <0x0>;
						};
					};

					rdma@3 {

						codec {
							sound-dai = <0x0>;
						};
					};

					rdma@4 {

						codec {
							sound-dai = <0x0>;
						};
					};

					rdma@5 {

						codec {
							sound-dai = <0x0>;
						};
					};

					rdma@6 {

						codec {
							sound-dai = <0x0>;
						};
					};

					rdma@7 {

						codec {
							sound-dai = <0x0>;
						};
					};

					wdma@0 {

						codec {
							sound-dai = <0x0>;
						};
					};

					wdma@1 {

						codec {
							sound-dai = <0x0>;
						};
					};

					wdma@2 {

						codec {
							sound-dai = <0x0>;
						};
					};

					wdma@3 {

						codec {
							sound-dai = <0x0>;
						};
					};

					wdma@4 {

						codec {
							sound-dai = <0x0>;
						};
					};

					uaif@0 {

						codec {
							sound-dai = <0x0>;
						};
					};

					uaif@1 {

						codec {
							sound-dai = <0x0>;
						};
					};

					uaif@2 {

						codec {
							sound-dai = <0x0>;
						};
					};

					uaif@4 {

						codec {
							sound-dai = <0x0>;
						};
					};

					dsif@0 {

						codec {
							sound-dai = <0x0>;
						};
					};

					spdy@0 {

						codec {
							sound-dai = <0x0>;
						};
					};

					sifs0@0 {

						codec {
							sound-dai = <0x0>;
						};
					};

					sifs1@0 {

						codec {
							sound-dai = <0x0>;
						};
					};

					sifs2@0 {

						codec {
							sound-dai = <0x0>;
						};
					};
				};

				dwmmc2@13550000 {
					pinctrl-0 = <0x10>;
				};
			};
		};

		fragment@5 {

			__overlay__ {
				hs_tune_param = <0x0>;
			};
		};

		fragment@6 {

			__overlay__ {
				hs_tune_param = <0x0>;
				ss_tune_param = <0x0>;
			};
		};

		fragment@12 {

			__overlay__ {
				lcd_info = <0x0>;
			};
		};

		fragment@34 {

			__overlay__ {

				rt5665@1b {
					pinctrl-0 = <0x0>;
					realtek,regulator_1v8 = <0x0>;
					realtek,regulator_3v3 = <0x0>;
				};
			};
		};

		fragment@39 {

			__overlay__ {

				sm5713@49 {
					pinctrl-0 = <0x0 0x4>;
				};
			};
		};
	};
};
